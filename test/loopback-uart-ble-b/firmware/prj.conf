## CMakeLists.txt
```
cmake_minimum_required(VERSION 3.20.0)

find_package(Zephyr REQUIRED HINTS $ENV{ZEPHYR_BASE})
project(vertex_testpeer_b C)

target_sources(app PRIVATE
    src/main.c
    src/proto.c
    src/agent.c
    src/uart_link.c
    src/ble_scan.c
)
target_include_directories(app PRIVATE src)
```

## prj.conf
```kconfig
# ─────────────────────────────────────────────────────────────────────────────
# Loopback test B — the peer TRANSMITS.
#
#   Pi ──UART 'T'──► peer advertises verbatim ──BLE──► Pi scans (raw HCI)
#
# This is the direction that validates the Pi's SCANNING path -- the scan
# interval and window BlueZ never exposed. The peer is reduced to a commanded
# advertiser, so its config drops everything receive-side: less running on the
# board means fewer explanations for a result.
# ─────────────────────────────────────────────────────────────────────────────

# ── uart0 belongs to the protocol, and nothing else ──────────────────────────
# See test A's config: both of these default to ON and write to uart0, and
# interleaved text corrupts binary frames in a way that looks like a link fault.
CONFIG_UART_CONSOLE=n
CONFIG_LOG_BACKEND_UART=n

CONFIG_LOG=y
CONFIG_LOG_MODE_DEFERRED=y
CONFIG_USE_SEGGER_RTT=y
CONFIG_LOG_BACKEND_RTT=y
CONFIG_RTT_CONSOLE=y

# ── UART ─────────────────────────────────────────────────────────────────────
CONFIG_SERIAL=y
CONFIG_UART_ASYNC_API=y

# Same silent-failure option as test A. It matters MORE here: direction B's
# inbound traffic is one 'T' frame per transmission and nothing else, so there
# is never any later traffic to top up a stalled DMA buffer. Without byte
# counting the peer would advertise the first payload and then appear to freeze.
CONFIG_UART_0_NRF_HW_ASYNC=y
CONFIG_UART_0_NRF_HW_ASYNC_TIMER=2

CONFIG_RING_BUFFER=y

# ── Bluetooth ────────────────────────────────────────────────────────────────
CONFIG_BT=y
CONFIG_BT_BROADCASTER=y             # advertising: the point of direction B
CONFIG_BT_OBSERVER=y                # only so the shared source links
CONFIG_BT_DEVICE_NAME="VERTEX-PEER"

# Advertising cadence is the reference the Pi's scan-window sweep is measured
# against, so it must be exact. bt_le_adv_update_data() replaces the payload
# without restarting the advertiser, which is what keeps the interval stable
# across a run.
CONFIG_BT_EXT_ADV=y
CONFIG_BT_CTLR_ADV_EXT=y

# NOTE -- channel map is NOT settable from config, and not from Zephyr's
# bt_le_adv_param either: the struct has no channel-map field, with or without
# extended advertising. Restricting the peer to channel 39 (2480 MHz, clear of
# Wi-Fi 1/6/11) needs a raw HCI command from the firmware -- the same
# bt_hci_cmd_send_sync() pattern that set_tx_power() uses in broadcaster.c.
# Until then the peer advertises on all three and only the Pi's channel map is
# controllable. See ble_scan.c's ble_adv_start(), which accepts chan_map and
# currently ignores it.

# ── stacks ───────────────────────────────────────────────────────────────────
CONFIG_MAIN_STACK_SIZE=2048
CONFIG_SYSTEM_WORKQUEUE_STACK_SIZE=2048
CONFIG_HEAP_MEM_POOL_SIZE=2048
```

## src/main.c
```c
/**
 * @file main.c
 * @brief Test peer for direction B: a commanded advertiser.
 *
 *     UART  T <AD bytes>  ──►  advertise those bytes verbatim
 *     UART  k / TXAT      ◄──  acknowledgement plus the board's TX timestamp
 *
 * The mirror of direction A, and deliberately smaller. Here the Pi does the
 * scanning, so this board never reports advertisements -- which removes the
 * bottleneck that voided direction A's measurement. In a busy room A had to relay
 * ~217 reports/s over a 115200 link, 96% of them from other devices, and dropped
 * its own data doing it. B moves that traffic to the Pi's HCI socket, where 21k
 * foreign adverts cost nothing.
 *
 * Scanning is therefore left OFF. Less running on the board means fewer
 * explanations for a result.
 */

#include <zephyr/kernel.h>
#include <zephyr/logging/log.h>
#include <string.h>

#include "agent.h"
#include "ble_scan.h"
#include "proto.h"
#include "uart_link.h"

LOG_MODULE_REGISTER(main, LOG_LEVEL_INF);

#define FW_VERSION          1u
#define DEFAULT_ADV_INT     0x00A0u     /* 100 ms in 0.625 ms units */

static struct agent agent;
static uint16_t tx_seq;

static void send_ack(uint8_t type, int status)
{
    uint8_t p[2] = { type, (uint8_t)(int8_t)status };
    (void)uart_link_send(PROTO_T_ACK, p, sizeof(p));
}

static void send_err(uint8_t type, int code)
{
    uint8_t p[2] = { type, (uint8_t)(int8_t)code };
    (void)uart_link_send(PROTO_T_ERR, p, sizeof(p));
}

/**
 * @brief Report when a payload actually reached the controller.
 *
 * The Pi brackets its own send and receive instants around this, which bounds
 * the clock offset to a UART round trip. Not a one-way delay -- the two clocks
 * share no origin -- but enough to separate advertising-interval effects.
 */
static void send_txat(uint16_t seq)
{
    uint8_t p[10];
    proto_st_u16(&p[0], seq);
    proto_st_u64(&p[2], (uint64_t)k_ticks_to_us_floor64(k_uptime_ticks()));
    int err = uart_link_send(PROTO_T_TXAT, p, sizeof(p));
    if (err) {
        /* From the host this is indistinguishable from a hang: it waits for a
         * reply that was built and then dropped. */
        LOG_ERR("TXAT seq %u dropped: %d", seq, err);
    }
}

static void on_frame(uint8_t type, const uint8_t *payload, uint16_t len, void *ctx)
{
    ARG_UNUSED(ctx);
    int rc = 0;

    /* Logged before dispatch: if the board hangs or faults inside a handler, this
     * is the last line and it names the culprit. */
    LOG_INF("frame 0x%02X, %u byte(s)", type, len);

    switch (type) {

    case PROTO_T_ADV_TX:
        if (len == 0u) {
            rc = ble_adv_stop();
            break;
        }
        /* Verbatim. The Pi supplies complete AD including element structure;
         * interpreting it here would defeat the instrument. */
        rc = ble_adv_set(payload, (uint8_t)len);
        if (rc == 0 && !ble_adv_running()) {
            rc = ble_adv_start(DEFAULT_ADV_INT, DEFAULT_ADV_INT, 0x07u);
        }
        if (rc == 0) {
            send_txat(++tx_seq);
            return;                     /* TXAT is the acknowledgement */
        }
        break;

    case PROTO_T_RADIO: {
        /* Payload format and bounds live in agent.h / agent_parse_radio(); this
         * board only applies them. Advertising half only: it does not scan, but
         * the scan fields are still validated so a bad frame is rejected the same
         * way on both peers. */
        struct radio_params r;
        rc = agent_parse_radio(payload, len, &r);
        if (rc != AGENT_OK) { break; }
        rc = r.advertising ? ble_adv_start(r.adv_min, r.adv_max, 0x07u)
                           : ble_adv_stop();
        break;
    }

    case PROTO_T_PING: {
        uint8_t p[8];
        proto_st_u64(p, (uint64_t)k_ticks_to_us_floor64(k_uptime_ticks()));
        (void)uart_link_send(PROTO_T_PONG, p, sizeof(p));
        return;
    }

    case PROTO_T_STATS_REQ: {
        /* Without these the Pi cannot trust a delivery ratio. Direction A's run
         * was voided by tx_dropped, and only reading it made that visible. */
        const struct uart_link_stats *u = uart_link_stats();
        const struct proto_stats     *p = uart_link_proto_stats();
        const struct ble_scan_stats  *b = ble_scan_stats();
        uint8_t o[48]; size_t n = 0;

        proto_st_u32(&o[n], b->reports);              n += 4;
        proto_st_u32(&o[n], b->queue_dropped);        n += 4;
        proto_st_u32(&o[n], b->oversize);             n += 4;
        proto_st_u32(&o[n], u->tx_frames);            n += 4;
        proto_st_u32(&o[n], u->tx_dropped);           n += 4;
        proto_st_u32(&o[n], u->rx_overrun_bytes);     n += 4;
        proto_st_u32(&o[n], u->rx_stopped);           n += 4;
        proto_st_u32(&o[n], u->rx_partial_flushes);   n += 4;
        proto_st_u32(&o[n], u->rx_full_flushes);      n += 4;
        proto_st_u32(&o[n], p->frames_ok);            n += 4;
        proto_st_u32(&o[n], p->crc_errors);           n += 4;
        proto_st_u32(&o[n], p->timeouts);             n += 4;

        (void)uart_link_send(PROTO_T_STATS, o, (uint16_t)n);
        return;
    }

    case PROTO_T_NETWORK:
    case PROTO_T_ALGORITHM:
    case PROTO_T_DISTURBANCE:
    case PROTO_T_CONTROL:
        /* Accepted and stored; nothing on this board runs a control law. Kept so
         * the config path stays exercised against real hardware. */
        rc = agent_apply_frame(&agent, type, payload, len,
                               k_ticks_to_us_floor64(k_uptime_ticks()));
        break;

    default:
        rc = -ENOTSUP;
        break;
    }

    if (rc == 0) {
        send_ack(type, 0);
    } else {
        send_err(type, rc);
        LOG_WRN("frame 0x%02X rejected: %d", type, rc);
    }
}

int main(void)
{
    agent_init(&agent);

    int err = uart_link_init(on_frame, NULL);
    if (err) {
        LOG_ERR("UART init failed: %d", err);
        return err;
    }

    err = ble_scan_init();              /* bt_enable only; no scanning started */
    if (err) {
        LOG_ERR("BLE init failed: %d", err);
        return err;
    }

    LOG_INF("test peer B v%u ready -- commanded advertiser, not scanning", FW_VERSION);
    return 0;
}
```

## src/agent.c
```c
#include "agent.h"

#include <string.h>

void agent_init(struct agent *a)
{
    memset(a, 0, sizeof(*a));
    a->params.dt    = 200;      /* ms */
    a->params.clock = 1000;     /* ms */
}

int8_t agent_neighbor_index(const struct agent *a, uint8_t node)
{
    for (uint8_t i = 0; i < a->params.n_neighbors; i++) {
        if (a->params.neighbors_id[i] == node) {
            return (int8_t)i;
        }
    }
    return -1;
}

static int apply_network(struct agent *a, const uint8_t *d, uint16_t len)
{
    /* Two mandatory bytes: enabled, node_id.*/
    if (len < PROTO_NETWORK_MIN_LEN) {
        return AGENT_ERR_LEN;
    }
    const uint16_t n = (uint16_t)(len - PROTO_NETWORK_MIN_LEN);
    if (n > AGENT_MAX_NEIGHBORS) {
        return AGENT_ERR_RANGE;
    }
    if (d[1] == 0u) {
        return AGENT_ERR_RANGE;         /* node id 0 is reserved */
    }

    a->params.enabled     = (d[0] == 1u);
    a->params.node_id     = d[1];
    a->params.n_neighbors = (uint8_t)n;

    for (uint16_t i = 0; i < n; i++) {
        a->params.neighbors_id[i] = d[i + PROTO_NETWORK_MIN_LEN];
    }
    /* Clear the tail so a shorter list cannot leave stale ids behind -- those
     * would still match in agent_neighbor_index() and admit a stranger. */
    for (uint16_t i = n; i < AGENT_MAX_NEIGHBORS; i++) {
        a->params.neighbors_id[i] = 0u;
    }
    return AGENT_OK;
}

static int apply_algorithm(struct agent *a, const uint8_t *d, uint16_t len)
{
    if (len != PROTO_ALGORITHM_LEN) {
        return AGENT_ERR_LEN;
    }
    const int32_t dt    = proto_ld_i32(&d[0]);
    const int32_t clock = proto_ld_i32(&d[4]);
    if (dt <= 0 || clock <= 0) {
        return AGENT_ERR_RANGE;         /* a zero period would spin the loop */
    }

    a->params.dt         = dt;
    a->params.clock      = clock;
    a->params.state_0    = proto_ld_i32(&d[8]);
    a->params.vstate_0   = proto_ld_i32(&d[12]);
    a->params.vartheta_0 = proto_ld_i32(&d[16]);
    a->params.counter_0  = proto_ld_i32(&d[20]);
    a->params.gain_ij    = proto_ld_i32(&d[24]);
    a->params.delta      = proto_ld_i32(&d[28]);
    a->params.eta        = proto_ld_i32(&d[32]);
    a->params.alpha      = proto_ld_i32(&d[36]);
    return AGENT_OK;
}

static int apply_disturbance(struct agent *a, const uint8_t *d, uint16_t len)
{
    if (len != PROTO_DISTURBANCE_LEN) {
        return AGENT_ERR_LEN;
    }
    const int32_t samples = proto_ld_i32(&d[25]);
    if (samples <= 0) {
        return AGENT_ERR_RANGE;         /* the counter wraps modulo this */
    }

    a->params.disturbance.active          = (d[0] == 1u);
    a->params.disturbance.sine_amplitude  = proto_ld_i32(&d[1]);
    a->params.disturbance.frequency       = proto_ld_i32(&d[5]);
    a->params.disturbance.phase           = proto_ld_i32(&d[9]);
    a->params.disturbance.noise_amplitude = proto_ld_i32(&d[13]);
    a->params.disturbance.noise_offset    = proto_ld_i32(&d[17]);
    a->params.disturbance.beta            = proto_ld_i32(&d[21]);
    a->params.disturbance.samples         = samples;
    return AGENT_OK;
}

static int apply_control(struct agent *a, const uint8_t *d, uint16_t len,
                         int64_t now_us)
{
    if (len != PROTO_CONTROL_LEN) {
        return AGENT_ERR_LEN;
    }

    if (d[0] == 1u) {
        a->params.seed                  = proto_ld_u32(&d[1]);
        a->params.epoch_us = 0u;
        for (unsigned i = 0; i < 6u; i++) {
            a->params.epoch_us |= (uint64_t)d[5 + i] << (8u * i);
        }
        a->params.running               = true;
        a->params.first_time_running    = true;
        a->params.all_neighbors_observed = false;

        for (uint8_t i = 0; i < AGENT_MAX_NEIGHBORS; i++) {
            a->params.available_neighbors[i] = false;
            a->params.neighbors_enabled[i]   = false;
            a->vars.neighbor_vstates[i]      = 0;
        }

        a->vars.state    = a->params.state_0;
        a->vars.vstate   = a->params.vstate_0;
        a->vars.vartheta = a->params.vartheta_0;
        a->vars.counter  = a->params.counter_0;
        a->vars.time_us  = now_us;
    } else {
        a->params.running            = false;
        a->params.first_time_running = false;
    }
    return AGENT_OK;
}

int agent_parse_radio(const uint8_t *payload, uint16_t len,
                      struct radio_params *out)
{
    if (len != PROTO_RADIO_LEN) {
        return AGENT_ERR_LEN;
    }
    const uint16_t adv_min   = proto_ld_u16(&payload[0]);
    const uint16_t adv_max   = proto_ld_u16(&payload[2]);
    const uint16_t scan_int  = proto_ld_u16(&payload[4]);
    const uint16_t scan_win  = proto_ld_u16(&payload[6]);
    const uint8_t  flags     = payload[8];

    if (scan_int == 0u || scan_win > scan_int) {
        return AGENT_ERR_RANGE;
    }
    if (adv_min == 0u || adv_min > adv_max) {
        return AGENT_ERR_RANGE;
    }

    /* Written only after every check, so a rejected frame leaves the caller's
     * previous configuration intact rather than half-updated. */
    out->adv_min       = adv_min;
    out->adv_max       = adv_max;
    out->scan_interval = scan_int;
    out->scan_window   = scan_win;
    out->active_scan   = (flags & AGENT_RADIO_ACTIVE_SCAN) != 0u;
    out->advertising   = (flags & AGENT_RADIO_ADVERTISING) != 0u;
    return AGENT_OK;
}

int agent_apply_frame(struct agent *a, uint8_t type, const uint8_t *payload,
                      uint16_t len, int64_t now_us)
{
    switch (type) {
    case PROTO_T_NETWORK:     return apply_network(a, payload, len);
    case PROTO_T_ALGORITHM:   return apply_algorithm(a, payload, len);
    case PROTO_T_DISTURBANCE: return apply_disturbance(a, payload, len);
    case PROTO_T_CONTROL:     return apply_control(a, payload, len, now_us);
    default:                  return AGENT_ERR_TYPE;
    }
}
```

## src/ble_scan.c
```c
#include "ble_scan.h"

#include <zephyr/bluetooth/bluetooth.h>
#include <zephyr/bluetooth/hci.h>
#include <zephyr/kernel.h>
#include <zephyr/logging/log.h>
#include <string.h>

LOG_MODULE_REGISTER(ble_scan, LOG_LEVEL_INF);

#define REPORT_QUEUE_DEPTH  16u

K_MSGQ_DEFINE(ble_report_queue, sizeof(struct ble_report), REPORT_QUEUE_DEPTH, 4);

static struct ble_scan_stats stats;
static bool adv_running;
static uint8_t adv_payload[BLE_MAX_AD_LEN];
static uint8_t adv_payload_len;

/* Raw AD passthrough: payload is handed to the stack as-is via a manufacturer-agnostic raw set. */
static struct bt_data adv_ad[1];

static void on_device_found(const bt_addr_le_t *addr, int8_t rssi, uint8_t adv_type,
                            struct net_buf_simple *ad)
{
    struct ble_report r;

    stats.reports++;

    if (ad->len > BLE_MAX_AD_LEN) {
        stats.oversize++;
        return;
    }

    r.timestamp_us = (uint64_t)k_ticks_to_us_floor64(k_uptime_ticks());
    r.rssi = rssi;
    r.adv_type = adv_type;
    r.addr_type = addr->type;
    memcpy(r.addr, addr->a.val, sizeof(r.addr));
    r.len = (uint8_t)ad->len;
    memcpy(r.data, ad->data, ad->len);

    /* Never block the BLE RX thread. */
    if (k_msgq_put(&ble_report_queue, &r, K_NO_WAIT) != 0) {
        stats.queue_dropped++;
    }
}

int ble_scan_init(void)
{
    int err = bt_enable(NULL);
    if (err) {
        LOG_ERR("bt_enable: %d", err);
        return err;
    }
    LOG_INF("Bluetooth initialised");
    return 0;
}

int ble_scan_start(uint16_t interval, uint16_t window, bool active)
{
    struct bt_le_scan_param p = {
        .type     = active ? BT_LE_SCAN_TYPE_ACTIVE : BT_LE_SCAN_TYPE_PASSIVE,
        .options  = BT_LE_SCAN_OPT_NONE,    /* duplicates REPORTED -- see the header */
        .interval = interval,
        .window   = window,
    };
    (void)bt_le_scan_stop();                /* idempotent restart */

    int err = bt_le_scan_start(&p, on_device_found);
    if (err) {
        LOG_ERR("bt_le_scan_start: %d", err);
        return err;
    }
    LOG_INF("scanning: interval=%u window=%u (%u%% duty) %s",
            interval, window, interval ? (100u * window / interval) : 0u,
            active ? "active" : "passive");
    return 0;
}

int ble_scan_stop(void)
{
    return bt_le_scan_stop();
}

int ble_adv_set(const uint8_t *data, uint8_t len)
{
    if (len > BLE_MAX_AD_LEN) {
        return -EMSGSIZE;
    }
    memcpy(adv_payload, data, len);
    adv_payload_len = len;

    if (!adv_running) {
        return 0;                           /* takes effect on the next start */
    }
    /* Update without stopping: a stop/start would reset the advertising cadence
     * on every payload change and make the interval sweep meaningless. */
    adv_ad[0].type = BT_DATA_MANUFACTURER_DATA;
    adv_ad[0].data = adv_payload;
    adv_ad[0].data_len = adv_payload_len;
    return bt_le_adv_update_data(adv_ad, 1, NULL, 0);
}

int ble_adv_start(uint16_t interval_min, uint16_t interval_max, uint8_t chan_map)
{
    struct bt_le_adv_param p = *BT_LE_ADV_NCONN;
    p.interval_min = interval_min;
    p.interval_max = interval_max;
    ARG_UNUSED(chan_map);   /* Zephyr exposes the channel map only via HCI or
                             * CONFIG_BT_CTLR_ADV_EXT; see the note in README. */

    adv_ad[0].type = BT_DATA_MANUFACTURER_DATA;
    adv_ad[0].data = adv_payload;
    adv_ad[0].data_len = adv_payload_len;

    if (adv_running) {
        (void)bt_le_adv_stop();
        adv_running = false;
    }
    int err = bt_le_adv_start(&p, adv_ad, 1, NULL, 0);
    if (err) {
        LOG_ERR("bt_le_adv_start: %d", err);
        return err;
    }
    adv_running = true;
    LOG_INF("advertising: interval %u..%u", interval_min, interval_max);
    return 0;
}

int ble_adv_stop(void)
{
    if (!adv_running) {
        return 0;
    }
    adv_running = false;
    return bt_le_adv_stop();
}

bool ble_adv_running(void) { return adv_running; }

const struct ble_scan_stats *ble_scan_stats(void) { return &stats; }
```

## src/ble_scan.h
```c
/**
 * @file ble_scan.h
 * @brief BLE observer: every advertising report, raw and unparsed.
 *
 * The instrument's defining property. It does NOT parse advertising data, does
 * NOT filter by manufacturer, and does NOT filter duplicates. It captures the raw
 * AD bytes and hands them to the host.
 *
 * Each of those is deliberate:
 *
 * - **No parsing.** The Pi already has a decoder. A second one here could
 *   disagree with it, and a peer that agrees with the host's bug is worse than
 *   no peer at all. Raw bytes let the host assert byte equality against exactly
 *   what it transmitted.
 * - **No duplicate filtering** (`BT_LE_SCAN_OPT_NONE`). The coordination firmware
 *   uses `BT_LE_SCAN_OPT_FILTER_DUPLICATE`, which suppresses a repeat of an
 *   identical payload. A suppressed duplicate is indistinguishable from a lost
 *   packet, so filtering makes delivery ratio unmeasurable.
 * - **Passive by default.** Active scanning transmits scan requests, spending
 *   airtime and perturbing the very coexistence being measured.
 */

#ifndef BLE_SCAN_H_
#define BLE_SCAN_H_

#include <stdbool.h>
#include <stdint.h>

#define BLE_MAX_AD_LEN      31u

struct ble_report {
    uint64_t timestamp_us;      /* capture instant, board clock */
    int8_t   rssi;
    uint8_t  addr[6];           /* little-endian, as it appears on the wire */
    uint8_t  addr_type;
    uint8_t  adv_type;
    uint8_t  len;
    uint8_t  data[BLE_MAX_AD_LEN];
};

extern struct k_msgq ble_report_queue;

struct ble_scan_stats {
    uint32_t reports;
    uint32_t queue_dropped;     /* consumer too slow -- NOT radio loss */
    uint32_t oversize;
};

int  ble_scan_init(void);
int  ble_scan_start(uint16_t interval, uint16_t window, bool active);
int  ble_scan_stop(void);

/** @brief Advertise @p data verbatim. Replaces the payload without stopping. */
int  ble_adv_set(const uint8_t *data, uint8_t len);
int  ble_adv_start(uint16_t interval_min, uint16_t interval_max, uint8_t chan_map);
int  ble_adv_stop(void);
bool ble_adv_running(void);

const struct ble_scan_stats *ble_scan_stats(void);

#endif /* BLE_SCAN_H_ */
```

## src/proto.h
```c
/**
 * @file proto.h
 * @brief Framed binary protocol between the Raspberry Pi and this board.
 *
 * Frame layout, all multi-byte fields LITTLE-endian:
 *
 *     +------+------+--------+-----------------+--------+
 *     | SOF  | TYPE | LEN:2  | PAYLOAD[LEN]    | CRC:2  |
 *     | 0x7E |      |        |                 |        |
 *     +------+------+--------+-----------------+--------+
 *                   \___________________________/
 *                     CRC-16/CCITT-FALSE covers
 *                     TYPE, LEN and PAYLOAD
 *
 * Three properties this buys, none of which a bare type-byte-plus-length has:
 *
 * 1. A dedicated start-of-frame byte. With binary payloads, any payload byte can
 *    equal a type code, so using the type as the sync marker means a corrupted
 *    stream re-synchronises inside a payload and silently accepts garbage.
 * 2. A CRC. Resync after corruption is then *detected* rather than hoped for, and
 *    the error is counted instead of applied as configuration.
 * 3. One flat parser for every frame type. 
 *
 * Endianness is little to match the rest of the platform: the BLE payload
 * (`vertex/wire/codec.py`), `custom_data_type` in the coordination firmware, and
 * the Cortex-M itself are all little-endian. Two endiannesses in one system is a
 * standing invitation to a field that reads plausibly and is wrong.
 */

#ifndef PROTO_H_
#define PROTO_H_

#include <stdbool.h>
#include <stddef.h>
#include <stdint.h>

#define PROTO_SOF               0x7Eu
#define PROTO_MAX_PAYLOAD       256u
#define PROTO_OVERHEAD          6u      /* SOF + TYPE + LEN(2) + CRC(2) */
#define PROTO_MAX_FRAME         (PROTO_MAX_PAYLOAD + PROTO_OVERHEAD)

/* Pi -> board */
#define PROTO_T_NETWORK         0x4Eu   /* 'N' */
#define PROTO_T_ALGORITHM       0x41u   /* 'A' -- note: 'A', not 0x61 ('a') */
#define PROTO_T_DISTURBANCE     0x44u   /* 'D' */
#define PROTO_T_CONTROL         0x53u   /* 'S' */
#define PROTO_T_ADV_TX          0x54u   /* 'T' -- advertise these AD bytes verbatim */
#define PROTO_T_RADIO           0x52u   /* 'R' -- set adv/scan parameters */
#define PROTO_T_PING            0x50u   /* 'P' */
#define PROTO_T_STATS_REQ       0x51u   /* 'Q' -- read counters */

/* board -> Pi */
#define PROTO_T_ADV_REPORT      0x72u   /* 'r' -- one advertising report */
#define PROTO_T_STATE           0x78u   /* 'x' -- one control step */
#define PROTO_T_TXAT            0x74u   /* 't' -- payload reached the controller */
#define PROTO_T_ACK             0x6Bu   /* 'k' */
#define PROTO_T_ERR             0x65u   /* 'e' */
#define PROTO_T_PONG            0x70u   /* 'p' */
#define PROTO_T_STATS           0x71u   /* 'q' -- counter dump */

/* Payload sizes for the fixed-length types. Network is variable. */
#define PROTO_MAX_NEIGHBORS     16u
#define PROTO_NETWORK_MIN_LEN   2u      /* enabled + node_id, zero neighbours */
#define PROTO_NETWORK_MAX_LEN   (PROTO_NETWORK_MIN_LEN + PROTO_MAX_NEIGHBORS)
#define PROTO_ALGORITHM_LEN     36u     /* 9 x int32 */
#define PROTO_DISTURBANCE_LEN   29u     /* 1 x uint8 + 7 x int32 */
#define PROTO_CONTROL_LEN       1u
#define PROTO_RADIO_LEN         9u
#define PROTO_PING_LEN          0u
#define PROTO_STATS_REQ_LEN     0u

enum proto_state {
    PROTO_WAIT_SOF = 0,
    PROTO_WAIT_TYPE,
    PROTO_WAIT_LEN_LO,
    PROTO_WAIT_LEN_HI,
    PROTO_WAIT_PAYLOAD,
    PROTO_WAIT_CRC_LO,
    PROTO_WAIT_CRC_HI,
};

struct proto_stats {
    uint32_t frames_ok;
    uint32_t crc_errors;
    uint32_t len_errors;
    uint32_t resyncs;       /* bad type/length or failed CRC: frame discarded */
    uint32_t timeouts;      /* frames abandoned because the line went idle */
    uint32_t bytes_in;
};

/**
 * @brief Called once per validated frame. Payload is only valid for the call.
 */
typedef void (*proto_frame_cb)(uint8_t type, const uint8_t *payload,
                               uint16_t len, void *ctx);

struct proto_parser {
    enum proto_state state;
    uint8_t  type;
    uint16_t expected_len;
    uint16_t received_len;
    uint16_t crc_rx;
    uint8_t  payload[PROTO_MAX_PAYLOAD];
    proto_frame_cb cb;
    void *ctx;
    struct proto_stats stats;
};

void     proto_parser_init(struct proto_parser *p, proto_frame_cb cb, void *ctx);
void     proto_parser_reset(struct proto_parser *p);
void     proto_feed(struct proto_parser *p, const uint8_t *data, size_t len);
uint16_t proto_crc16(const uint8_t *data, size_t len);

/**
 * @brief True while a frame is partially received.
 *
 * The transport uses this to decide whether an idle line means "nothing to do"
 * or "a frame was cut short" -- see :c:func:`proto_parser_timeout`.
 */
static inline bool proto_parser_in_frame(const struct proto_parser *p)
{
    return p->state != PROTO_WAIT_SOF;
}

/**
 * @brief Abandon a partially received frame. Call when the line has been idle.
 *
 * Necessary because a mid-payload SOF byte is deliberately NOT treated as a new
 * frame: payloads are binary and contain every byte value, so honouring an
 * embedded 0x7E would corrupt every frame that happens to carry one.
 *
 * Recommended: 100 ms of silence while ``proto_parser_in_frame()``. Truncation on
 * USB CDC essentially only happens when the host dies or reopens the port
 * mid-write, so the timeout is a recovery path rather than a hot one.
 */
void     proto_parser_timeout(struct proto_parser *p);

/**
 * @brief Build a frame into @p out.
 * @return total bytes written, or 0 if @p out is too small or the payload too big.
 */
size_t proto_build(uint8_t *out, size_t out_size, uint8_t type,
                   const uint8_t *payload, uint16_t len);

/* Little-endian field accessors. Byte-wise, so they are alignment-safe:
 * a payload sits at an arbitrary offset in a buffer and a cast would fault
 * on a strict-alignment target. */
static inline uint16_t proto_ld_u16(const uint8_t *p)
{
    return (uint16_t)((uint16_t)p[0] | ((uint16_t)p[1] << 8));
}

static inline uint32_t proto_ld_u32(const uint8_t *p)
{
    return ((uint32_t)p[0]) | ((uint32_t)p[1] << 8) |
           ((uint32_t)p[2] << 16) | ((uint32_t)p[3] << 24);
}

static inline int32_t proto_ld_i32(const uint8_t *p)
{
    return (int32_t)proto_ld_u32(p);
}

static inline void proto_st_u16(uint8_t *p, uint16_t v)
{
    p[0] = (uint8_t)(v & 0xFFu);
    p[1] = (uint8_t)(v >> 8);
}

static inline void proto_st_u32(uint8_t *p, uint32_t v)
{
    p[0] = (uint8_t)(v & 0xFFu);
    p[1] = (uint8_t)((v >> 8) & 0xFFu);
    p[2] = (uint8_t)((v >> 16) & 0xFFu);
    p[3] = (uint8_t)((v >> 24) & 0xFFu);
}

static inline void proto_st_u64(uint8_t *p, uint64_t v)
{
    for (unsigned i = 0; i < 8u; i++) {
        p[i] = (uint8_t)((v >> (8u * i)) & 0xFFu);
    }
}

#endif /* PROTO_H_ */
```

## src/uart_link.c
```c
#include "uart_link.h"

#include <zephyr/device.h>
#include <zephyr/devicetree.h>
#include <zephyr/drivers/uart.h>
#include <zephyr/kernel.h>
#include <zephyr/logging/log.h>
#include <zephyr/sys/atomic.h>
#include <zephyr/sys/ring_buffer.h>

LOG_MODULE_REGISTER(uart_link, LOG_LEVEL_INF);


static const struct device *const uart = DEVICE_DT_GET(DT_NODELABEL(uart0));

#define DMA_BUF_SIZE        256u
#define RX_RING_SIZE        1024u
#define RX_IDLE_TIMEOUT_US  1000u
#define TX_QUEUE_DEPTH      8u

/* A frame left incomplete is abandoned after this much silence. */
#define FRAME_IDLE_TIMEOUT_MS 100

RING_BUF_DECLARE(rx_ring, RX_RING_SIZE);

static uint8_t dma_buf[2][DMA_BUF_SIZE];
static uint8_t active_buf;

struct tx_entry {
    uint16_t len;
    uint8_t  data[PROTO_MAX_FRAME];
};

K_MSGQ_DEFINE(tx_queue, sizeof(struct tx_entry), TX_QUEUE_DEPTH, 4);

static struct proto_parser        parser;
static struct uart_link_stats     stats;
static struct tx_entry            tx_current;
static volatile bool              tx_in_progress;

static void rx_work_handler(struct k_work *work);
static void tx_work_handler(struct k_work *work);
static void idle_work_handler(struct k_work *work);

static K_WORK_DEFINE(rx_work, rx_work_handler);
static K_WORK_DEFINE(tx_work, tx_work_handler);
static K_WORK_DELAYABLE_DEFINE(idle_work, idle_work_handler);

/* ---- RX --------------------------------------------------------------- */

static void rx_work_handler(struct k_work *work)
{
    ARG_UNUSED(work);
    uint8_t chunk[64];
    uint32_t n;

    /* Drain in chunks rather than a byte at a time: same result, far fewer
     * ring-buffer calls when a full DMA buffer lands. */
    while ((n = ring_buf_get(&rx_ring, chunk, sizeof(chunk))) > 0u) {
        proto_feed(&parser, chunk, n);
    }

    /* Arm or disarm the frame-idle timeout based on whether a frame is open. */
    if (proto_parser_in_frame(&parser)) {
        k_work_reschedule(&idle_work, K_MSEC(FRAME_IDLE_TIMEOUT_MS));
    } else {
        k_work_cancel_delayable(&idle_work);
    }
}

static void idle_work_handler(struct k_work *work)
{
    ARG_UNUSED(work);
    if (proto_parser_in_frame(&parser)) {
        LOG_WRN("frame timed out mid-payload; resyncing");
        proto_parser_timeout(&parser);
    }
}

/* ---- TX --------------------------------------------------------------- */

static void tx_work_handler(struct k_work *work)
{
    ARG_UNUSED(work);
    if (tx_in_progress) {
        return;
    }
    if (k_msgq_get(&tx_queue, &tx_current, K_NO_WAIT) != 0) {
        return;                                     /* nothing queued */
    }
    tx_in_progress = true;
    int err = uart_tx(uart, tx_current.data, tx_current.len, SYS_FOREVER_US);
    if (err) {
        LOG_ERR("uart_tx failed: %d", err);
        tx_in_progress = false;
        stats.tx_dropped++;
    } else {
        stats.tx_frames++;
    }
}

int uart_link_send(uint8_t type, const uint8_t *payload, uint16_t len)
{
    struct tx_entry e;
    size_t n = proto_build(e.data, sizeof(e.data), type, payload, len);
    if (n == 0u) {
        return -EINVAL;
    }
    e.len = (uint16_t)n;

    /* Never block. This is called from the BLE report path and from the control
     * loop; a full queue must cost a dropped report, not a stalled radio. */
    if (k_msgq_put(&tx_queue, &e, K_NO_WAIT) != 0) {
        stats.tx_dropped++;
        return -ENOMEM;
    }
    k_work_submit(&tx_work);
    return 0;
}

/* ---- driver callback --------------------------------------------------- */

static void uart_cb(const struct device *dev, struct uart_event *evt, void *user_data)
{
    ARG_UNUSED(user_data);

    switch (evt->type) {

    case UART_RX_RDY: {
        if (evt->data.rx.len < DMA_BUF_SIZE) {
            stats.rx_partial_flushes++;     /* idle timeout fired */
        } else {
            stats.rx_full_flushes++;
        }
        uint32_t put = ring_buf_put(&rx_ring,
                                    evt->data.rx.buf + evt->data.rx.offset,
                                    evt->data.rx.len);
        if (put < evt->data.rx.len) {
            stats.rx_overrun_bytes += (evt->data.rx.len - put);
        }
        k_work_submit(&rx_work);
        break;
    }

    case UART_RX_BUF_REQUEST:
        active_buf ^= 1u;
        uart_rx_buf_rsp(dev, dma_buf[active_buf], DMA_BUF_SIZE);
        break;

    case UART_RX_BUF_RELEASED:
        break;

    case UART_RX_STOPPED:
        stats.rx_stopped++;
        LOG_WRN("UART RX stopped (reason 0x%x); will re-enable",
                (unsigned)evt->data.rx_stop.reason);
        break;

    case UART_RX_DISABLED: {
        /* Re-arm, or the link goes silently deaf after the first bus error. */
        active_buf = 0u;
        int err = uart_rx_enable(dev, dma_buf[active_buf], DMA_BUF_SIZE,
                                 RX_IDLE_TIMEOUT_US);
        if (err) {
            LOG_ERR("UART RX re-enable failed: %d", err);
        }
        proto_parser_reset(&parser);
        break;
    }

    case UART_TX_DONE:
        tx_in_progress = false;
        k_work_submit(&tx_work);            /* drain the next queued frame */
        break;

    case UART_TX_ABORTED:
        LOG_ERR("UART TX aborted");
        tx_in_progress = false;
        k_work_submit(&tx_work);
        break;

    default:
        break;
    }
}

int uart_link_init(proto_frame_cb cb, void *ctx)
{
    if (!device_is_ready(uart)) {
        LOG_ERR("UART device not ready");
        return -ENODEV;
    }
    proto_parser_init(&parser, cb, ctx);

    int err = uart_callback_set(uart, uart_cb, NULL);
    if (err) {
        LOG_ERR("uart_callback_set: %d", err);
        return err;
    }
    active_buf = 0u;
    err = uart_rx_enable(uart, dma_buf[active_buf], DMA_BUF_SIZE, RX_IDLE_TIMEOUT_US);
    if (err) {
        LOG_ERR("uart_rx_enable: %d", err);
        return err;
    }
    LOG_INF("UART link up");
    return 0;
}

const struct uart_link_stats *uart_link_stats(void)       { return &stats; }
const struct proto_stats     *uart_link_proto_stats(void) { return &parser.stats; }
```
