## CMakeLists.txt
```
cmake_minimum_required(VERSION 3.20.0)

find_package(Zephyr REQUIRED HINTS $ENV{ZEPHYR_BASE})
project(NONE)

# NORDIC SDK APP START
target_sources(app PRIVATE
  src/main.c
  src/agent.c
  src/ble_scan.c
  src/proto.c
  src/uart_link.c
)

# NORDIC SDK APP END
zephyr_library_include_directories(.)
```

## prj.conf
```kconfig
# ─────────────────────────────────────────────────────────────────────────────
# Loopback test A — the peer RECEIVES.
#
#   Pi advertises ──BLE──► peer scans ──UART──► Pi
#
# The peer's job is to miss nothing and report everything, so this config is
# tuned for receive throughput. Its own advertiser stays off (run_a.py sends
# advertising=False); it is compiled in only because the shared source calls
# bt_le_adv_start().
# ─────────────────────────────────────────────────────────────────────────────

# ── uart0 belongs to the protocol, and nothing else ──────────────────────────
# Both of these default to ON and both write to uart0. Console output or log
# text interleaved with binary frames corrupts them, and the CRC then rejects
# frames that were never damaged on the wire -- which reads as a link fault.
# The nRF52-DK has an onboard J-Link, so RTT costs nothing and keeps uart0 clean.
CONFIG_UART_CONSOLE=n
CONFIG_LOG_BACKEND_UART=n

CONFIG_LOG=y
CONFIG_LOG_MODE_DEFERRED=y          # never log from the BLE RX or UART callback
CONFIG_USE_SEGGER_RTT=y
CONFIG_LOG_BACKEND_RTT=y
CONFIG_RTT_CONSOLE=y
# read it with:  JLinkRTTLogger  /  nrfjprog --rtt  /  west attach

# ── UART ─────────────────────────────────────────────────────────────────────
CONFIG_SERIAL=y
CONFIG_UART_ASYNC_API=y

# THE option that fails silently if omitted. A dedicated TIMER counts received
# bytes via PPI, which is the only way the async driver can flush a PARTIAL DMA
# buffer on the idle timeout rather than waiting for 256 bytes. Without it a
# 42-byte config frame sits in the buffer until unrelated traffic tops it up,
# and commands appear to be ignored at random.
#
# Verify at runtime: query 'Q' and read rx_partial_flushes. Zero after the host
# has sent frames means this is not active.
#
# TIMER0 belongs to the BLE controller; TIMER2 is free.
CONFIG_UART_0_NRF_HW_ASYNC=y
CONFIG_UART_0_NRF_HW_ASYNC_TIMER=2

CONFIG_RING_BUFFER=y

# ── Bluetooth ────────────────────────────────────────────────────────────────
CONFIG_BT=y
CONFIG_BT_OBSERVER=y                # scanning: the point of direction A
CONFIG_BT_BROADCASTER=y             # only so the shared source links
CONFIG_BT_DEVICE_NAME="VERTEX-PEER"

# Report throughput. Every advertising report crosses the controller-to-host
# boundary through these buffers; too few and the CONTROLLER drops reports,
# which is invisible to us and indistinguishable from radio loss.
CONFIG_BT_BUF_EVT_RX_COUNT=16
CONFIG_BT_BUF_EVT_RX_SIZE=255
# the scan callback runs on this stack
CONFIG_BT_RX_STACK_SIZE=2048

# ── stacks ───────────────────────────────────────────────────────────────────
CONFIG_MAIN_STACK_SIZE=2048
CONFIG_SYSTEM_WORKQUEUE_STACK_SIZE=2048
CONFIG_HEAP_MEM_POOL_SIZE=2048
```

## src/main.c
```c
/**
 * @file main.c
 * @brief Test peer: a transparent bridge between the UART and the BLE
 *        advertising channel.
 *
 *     UART  T frame (AD bytes)   ──►  advertise those bytes verbatim
 *     UART  r frame (report)     ◄──  every advertising report, raw
 *
 * Producer/consumer, as sketched in the prototype:
 *   - the BLE RX thread captures reports into a message queue and returns;
 *   - this thread drains the queue and frames them onto the UART.
 *
 * The split exists so a slow UART can never stall the radio. If the queue fills,
 * reports are dropped and *counted* -- an uncounted drop would appear in the
 * host's analysis as packet loss over the air, which is precisely the measurement
 * this board exists to make trustworthy.
 */

#include <zephyr/kernel.h>
#include <zephyr/logging/log.h>
#include <string.h>

#include "agent.h"
#include "ble_scan.h"
#include "proto.h"
#include "uart_link.h"

LOG_MODULE_REGISTER(main, LOG_LEVEL_INF);

#define FW_VERSION          1u
#define DEFAULT_SCAN_INT    0x00A0u     /* 100 ms in 0.625 ms units */
#define DEFAULT_SCAN_WIN    0x00A0u     /* window == interval: 100% duty */

static struct agent agent;

/* ---- inbound frames ---------------------------------------------------- */

static void send_ack(uint8_t type, int status)
{
    uint8_t p[2] = { type, (uint8_t)(int8_t)status };
    (void)uart_link_send(PROTO_T_ACK, p, sizeof(p));
}

static void send_err(uint8_t type, int code)
{
    uint8_t p[2] = { type, (uint8_t)(int8_t)code };
    (void)uart_link_send(PROTO_T_ERR, p, sizeof(p));
}

static void on_frame(uint8_t type, const uint8_t *payload, uint16_t len, void *ctx)
{
    ARG_UNUSED(ctx);
    int rc = 0;

    /* Logged before dispatch: if the board hangs or faults inside a handler, this
     * is the last line and it names the culprit. */
    LOG_INF("frame 0x%02X, %u byte(s)", type, len);

    switch (type) {

    case PROTO_T_ADV_TX:
        /* Verbatim: the host supplies complete AD, including element structure.
         * Interpreting it here would defeat the purpose of the instrument. */
        rc = ble_adv_set(payload, (uint8_t)len);
        if (rc == 0 && len > 0u) {
            rc = ble_adv_start(DEFAULT_SCAN_INT, DEFAULT_SCAN_INT, 0x07u);
        }
        break;

    case PROTO_T_RADIO: {
        /* Payload format and bounds live in agent.h / agent_parse_radio(); this
         * board only applies them. Both halves: direction A scans here. */
        struct radio_params r;
        rc = agent_parse_radio(payload, len, &r);
        if (rc != AGENT_OK) { break; }
        rc = ble_scan_start(r.scan_interval, r.scan_window, r.active_scan);
        if (rc == 0) {
            rc = r.advertising ? ble_adv_start(r.adv_min, r.adv_max, 0x07u)
                               : ble_adv_stop();
        }
        break;
    }

    case PROTO_T_PING: {
        uint8_t p[8];
        proto_st_u64(p, (uint64_t)k_ticks_to_us_floor64(k_uptime_ticks()));
        (void)uart_link_send(PROTO_T_PONG, p, sizeof(p));
        return;                             /* PONG is the acknowledgement */
    }

    case PROTO_T_STATS_REQ: {
        /* Without these the host cannot trust a delivery ratio: a report dropped
         * inside the peer is indistinguishable from one lost over the air. */
        const struct uart_link_stats *u = uart_link_stats();
        const struct proto_stats     *p = uart_link_proto_stats();
        const struct ble_scan_stats  *b = ble_scan_stats();
        uint8_t o[48]; size_t n = 0;

        proto_st_u32(&o[n], b->reports);              n += 4;
        proto_st_u32(&o[n], b->queue_dropped);        n += 4;
        proto_st_u32(&o[n], b->oversize);             n += 4;
        proto_st_u32(&o[n], u->tx_frames);            n += 4;
        proto_st_u32(&o[n], u->tx_dropped);           n += 4;
        proto_st_u32(&o[n], u->rx_overrun_bytes);     n += 4;
        proto_st_u32(&o[n], u->rx_stopped);           n += 4;
        proto_st_u32(&o[n], u->rx_partial_flushes);   n += 4;
        proto_st_u32(&o[n], u->rx_full_flushes);      n += 4;
        proto_st_u32(&o[n], p->frames_ok);            n += 4;
        proto_st_u32(&o[n], p->crc_errors);           n += 4;
        proto_st_u32(&o[n], p->timeouts);             n += 4;

        (void)uart_link_send(PROTO_T_STATS, o, (uint16_t)n);
        return;
    }

    case PROTO_T_NETWORK:
    case PROTO_T_ALGORITHM:
    case PROTO_T_DISTURBANCE:
    case PROTO_T_CONTROL:
        rc = agent_apply_frame(&agent, type, payload, len,
                               k_ticks_to_us_floor64(k_uptime_ticks()));
        break;

    default:
        rc = -ENOTSUP;
        break;
    }

    if (rc == 0) {
        send_ack(type, 0);
    } else {
        /* Report the failure rather than logging it: the host is the only place
         * that can correlate a rejected frame with what it sent. */
        send_err(type, rc);
        LOG_WRN("frame 0x%02X rejected: %d", type, rc);
    }
}

/* ---- report thread ----------------------------------------------------- */

#define REPORT_STACK_SIZE   2048
#define REPORT_PRIORITY     5

static void report_thread(void *a, void *b, void *c)
{
    ARG_UNUSED(a); ARG_UNUSED(b); ARG_UNUSED(c);
    struct ble_report r;
    uint8_t payload[8 + 1 + 6 + 1 + 1 + BLE_MAX_AD_LEN];

    while (1) {
        /* Blocks until a report arrives; no polling, no busy wait. */
        if (k_msgq_get(&ble_report_queue, &r, K_FOREVER) != 0) {
            continue;
        }

        /* [timestamp_us:8][rssi:1][addr_type:1][addr:6][adv_type:1][len:1][data] */
        size_t n = 0;
        proto_st_u64(&payload[n], r.timestamp_us);      n += 8;
        payload[n++] = (uint8_t)r.rssi;
        payload[n++] = r.addr_type;
        memcpy(&payload[n], r.addr, 6);                 n += 6;
        payload[n++] = r.adv_type;
        payload[n++] = r.len;
        memcpy(&payload[n], r.data, r.len);             n += r.len;

        (void)uart_link_send(PROTO_T_ADV_REPORT, payload, (uint16_t)n);
    }
}

K_THREAD_DEFINE(report_tid, REPORT_STACK_SIZE, report_thread, NULL, NULL, NULL,
                REPORT_PRIORITY, 0, 0);

/* ---- entry ------------------------------------------------------------- */

int main(void)
{
    agent_init(&agent);

    int err = uart_link_init(on_frame, NULL);
    if (err) {
        LOG_ERR("UART init failed: %d", err);
        return err;
    }

    err = ble_scan_init();
    if (err) {
        LOG_ERR("BLE init failed: %d", err);
        return err;
    }

    /* Scan immediately at 100% duty. The host narrows the window deliberately
     * when it wants to measure the effect; the default should be the
     * configuration that loses nothing. */
    err = ble_scan_start(DEFAULT_SCAN_INT, DEFAULT_SCAN_WIN, false);
    if (err) {
        LOG_ERR("scan start failed: %d", err);
        return err;
    }

    LOG_INF("test peer v%u ready", FW_VERSION);
    return 0;
}
```

## src/agent.h
```c
/**
 * @file agent.h
 * @brief Agent state and configuration decoding.
 *
 * All scaled quantities are int32 in units of 1e-6, matching the platform's
 * fixed-point convention (`vertex/numeric.py`). Fields arrive little-endian.
 *
 * ## Payload formats
 *
 * `proto.h` owns the *envelope* -- SOF, type, length, CRC -- which is identical
 * for every message on the link. What each payload means is this application's
 * business, so it is documented here, beside the code that decodes it.
 *
 * Periods are MILLISECONDS; every other scaled field is int32 in units of 1e-6.
 *
 *     NETWORK  'N'  >= 2 bytes   [enabled:1][node_id:1][neighbor_id:1 x n]
 *     ALGORITHM  'A'  36 bytes   [dt_ms:4][clock_ms:4][state_0:4][vstate_0:4]
 *                                [vartheta_0:4][counter_0:4][gain_ij:4][delta:4][eta:4][alpha:4]
 *     DISTURBANCE  'D'  29 bytes [active:1][sine_amplitude:4][frequency:4][phase:4]
 *                                [noise_amplitude:4][noise_offset:4][beta:4][samples:4]
 *     CONTROL  'S'  5 bytes      [run:1][seed:4]
 *     RADIO  'R'  9 bytes        [adv_min:2][adv_max:2][scan_int:2][scan_win:2][flags:1]
 *                                0.625 ms units; flags bit0 = active scan,
 *                                bit1 = advertising enabled. Requires
 *                                scan_int != 0 and scan_win <= scan_int.
 *     ADV_TX  'T'  <= 31 bytes   complete AD, advertised verbatim
 *
 * RADIO and ADV_TX are applied in main.c, which owns the radio; the four frames
 * above them decode here.
 */

#ifndef AGENT_H_
#define AGENT_H_

#include <stdbool.h>
#include <stdint.h>

#include "proto.h"

#define AGENT_MAX_NEIGHBORS     PROTO_MAX_NEIGHBORS

/* RADIO flag bits, as documented above. */
#define AGENT_RADIO_ACTIVE_SCAN 0x01u
#define AGENT_RADIO_ADVERTISING 0x02u

/* Errors returned by agent_apply_frame */
#define AGENT_OK                0
#define AGENT_ERR_LEN          (-1)     /* payload length wrong for the type */
#define AGENT_ERR_RANGE        (-2)     /* a field is out of range */
#define AGENT_ERR_TYPE         (-3)     /* not a configuration frame */

struct disturbance_params {
    bool    active;
    int32_t sine_amplitude;     /* M        */
    int32_t frequency;
    int32_t phase;
    int32_t noise_amplitude;    /* O        */
    int32_t noise_offset;       /* O_offset */
    int32_t beta;
    int32_t samples;
};

struct agent_params {
    bool    enabled;
    bool    running;
    bool    first_time_running;
    bool    all_neighbors_observed;

    uint8_t node_id;
    uint8_t n_neighbors;
    uint8_t neighbors_id[AGENT_MAX_NEIGHBORS];
    
    bool    available_neighbors[AGENT_MAX_NEIGHBORS];
    bool    neighbors_enabled[AGENT_MAX_NEIGHBORS];

    int32_t dt;                 /* ms */
    int32_t clock;              /* ms */
    int32_t state_0;
    int32_t vstate_0;
    int32_t vartheta_0;
    int32_t counter_0;
    int32_t gain_ij;        /* coupling gain, the paper's a_ij */
    int32_t alpha;          /* sign-power EXPONENT, not a gain */
    int32_t delta;
    int32_t eta;
    uint32_t seed;              /* per-run PRNG seed */
    uint64_t epoch_us;          /* host's epoch reading at trigger */
                                /* Both stored, unused here: this peer runs no
                                 * control law and stamps no packets. Decoded
                                 * anyway so the frame length agrees with the
                                 * host's encoder -- a peer expecting a shorter
                                 * CONTROL rejects it with -EINVAL on the bench. */
    struct disturbance_params disturbance;
};

struct agent_vars {
    int32_t state;
    int32_t vstate;
    int32_t vartheta;
    int32_t counter;
    int64_t time_us;
    int32_t neighbor_vstates[AGENT_MAX_NEIGHBORS];
};

struct agent {
    struct agent_params params;
    struct agent_vars   vars;
};

void agent_init(struct agent *a);

/**
 * @brief Apply one configuration frame.
 *
 * @param now_us Current time, injected so this unit stays host-testable. Only
 *               read when a control frame starts a run.
 * @return AGENT_OK, or a negative AGENT_ERR_*. The caller reports the failure to
 *         the host; a rejected frame must never be partially applied, which is
 *         why every length check precedes the first assignment.
 */
int agent_apply_frame(struct agent *a, uint8_t type, const uint8_t *payload,
                      uint16_t len, int64_t now_us);

/** @brief Radio configuration decoded from a RADIO frame, in 0.625 ms units. */
struct radio_params {
    uint16_t adv_min;
    uint16_t adv_max;
    uint16_t scan_interval;
    uint16_t scan_window;
    bool     active_scan;
    bool     advertising;
};

/**
 * @brief Decode and validate a RADIO payload.
 *
 * Split from applying it so the bounds checks sit beside the other frame decoders
 * and stay host-testable, while the effect -- starting the radio -- stays with the
 * module that owns it.
 *
 * @return AGENT_OK, or AGENT_ERR_LEN / AGENT_ERR_RANGE. @p out is untouched on
 *         failure, so a rejected frame cannot half-apply.
 */
int agent_parse_radio(const uint8_t *payload, uint16_t len,
                      struct radio_params *out);

/** @brief Index of @p node in the neighbour list, or -1. */
int8_t agent_neighbor_index(const struct agent *a, uint8_t node);

#endif /* AGENT_H_ */
```

## src/ble_scan.c
```c
#include "ble_scan.h"

#include <zephyr/bluetooth/bluetooth.h>
#include <zephyr/bluetooth/hci.h>
#include <zephyr/kernel.h>
#include <zephyr/logging/log.h>
#include <string.h>

LOG_MODULE_REGISTER(ble_scan, LOG_LEVEL_INF);

#define REPORT_QUEUE_DEPTH  16u

K_MSGQ_DEFINE(ble_report_queue, sizeof(struct ble_report), REPORT_QUEUE_DEPTH, 4);

static struct ble_scan_stats stats;
static bool adv_running;
static uint8_t adv_payload[BLE_MAX_AD_LEN];
static uint8_t adv_payload_len;

/* The host supplies COMPLETE AdvData -- already element-structured. Zephyr's
 * advertising API takes an array of elements, not raw bytes, so the incoming
 * buffer is split back into elements and handed over unchanged.
 *
 * Wrapping the whole buffer as one BT_DATA_MANUFACTURER_DATA element instead
 * fails silently: the air carries `1E FF <the host's entire AD>`, which fits 31
 * bytes, so nothing errors -- but the receiver reads the first two bytes of the
 * host's FIRST element as the company id and calls every advertisement somebody
 * else's. Zero deliveries, zero mismatches, no error anywhere.
 *
 * Splitting is not parsing: values are copied byte for byte, never interpreted. */
#define ADV_MAX_ELEMENTS   8
static struct bt_data adv_ad[ADV_MAX_ELEMENTS];
static uint8_t adv_ad_count;

/* Requested advertising parameters, remembered so RADIO and ADV_TX may arrive in
 * either order. Advertising cannot start without a payload, and the payload
 * cannot be chosen before the host sends one -- so a parameter request that
 * arrives first is deferred and applied when the payload turns up. Requiring a
 * fixed order instead just moves the failure into the host. */
static uint16_t adv_req_min = 0x00A0u;      /* 100 ms in 0.625 ms units */
static uint16_t adv_req_max = 0x00A0u;
static uint8_t  adv_req_chan_map = 0x07u;
static bool     adv_requested;

/* Split adv_payload's first @len bytes into bt_data elements.
 * Element layout is len(1) | type(1) | value(len-1); the length byte counts
 * type + value, not the element's total size. bt_data.data points into
 * adv_payload, which is static -- the stack keeps these pointers. */
static int split_adv_payload(uint8_t len)
{
    uint8_t n = 0;
    uint8_t i = 0;

    while (i < len) {
        uint8_t l = adv_payload[i];
        if (l == 0u) {
            break;                      /* zero length terminates: padding */
        }
        if ((uint16_t)i + 1u + l > len) {
            LOG_ERR("AD element at %u declares %u bytes, %u remain",
                    i, l, len - i - 1u);
            return -EINVAL;
        }
        if (n >= ADV_MAX_ELEMENTS) {
            LOG_ERR("more than %u AD elements", ADV_MAX_ELEMENTS);
            return -E2BIG;
        }
        adv_ad[n].type = adv_payload[i + 1u];
        adv_ad[n].data = &adv_payload[i + 2u];
        adv_ad[n].data_len = (uint8_t)(l - 1u);
        n++;
        i = (uint8_t)(i + 1u + l);
    }

    if (n == 0u) {
        return -EINVAL;
    }
    adv_ad_count = n;
    return 0;
}

static void on_device_found(const bt_addr_le_t *addr, int8_t rssi, uint8_t adv_type,
                            struct net_buf_simple *ad)
{
    struct ble_report r;

    stats.reports++;

    if (ad->len > BLE_MAX_AD_LEN) {
        stats.oversize++;
        return;
    }

    r.timestamp_us = (uint64_t)k_ticks_to_us_floor64(k_uptime_ticks());
    r.rssi = rssi;
    r.adv_type = adv_type;
    r.addr_type = addr->type;
    memcpy(r.addr, addr->a.val, sizeof(r.addr));
    r.len = (uint8_t)ad->len;
    memcpy(r.data, ad->data, ad->len);

    /* Never block the BLE RX thread. */
    if (k_msgq_put(&ble_report_queue, &r, K_NO_WAIT) != 0) {
        stats.queue_dropped++;
    }
}

int ble_scan_init(void)
{
    int err = bt_enable(NULL);
    if (err) {
        LOG_ERR("bt_enable: %d", err);
        return err;
    }
    LOG_INF("Bluetooth initialised");
    return 0;
}

int ble_scan_start(uint16_t interval, uint16_t window, bool active)
{
    struct bt_le_scan_param p = {
        .type     = active ? BT_LE_SCAN_TYPE_ACTIVE : BT_LE_SCAN_TYPE_PASSIVE,
        .options  = BT_LE_SCAN_OPT_NONE,    /* duplicates REPORTED -- see the header */
        .interval = interval,
        .window   = window,
    };
    (void)bt_le_scan_stop();                /* idempotent restart */

    int err = bt_le_scan_start(&p, on_device_found);
    if (err) {
        LOG_ERR("bt_le_scan_start: %d", err);
        return err;
    }
    LOG_INF("scanning: interval=%u window=%u (%u%% duty) %s",
            interval, window, interval ? (100u * window / interval) : 0u,
            active ? "active" : "passive");
    return 0;
}

int ble_scan_stop(void)
{
    return bt_le_scan_stop();
}

int ble_adv_set(const uint8_t *data, uint8_t len)
{
    if (len > BLE_MAX_AD_LEN) {
        return -EMSGSIZE;
    }
    memcpy(adv_payload, data, len);
    adv_payload_len = len;

    int err = split_adv_payload(len);
    if (err) {
        return err;
    }
    if (!adv_running) {
        /* Honour a parameter request that arrived before any payload. */
        if (adv_requested) {
            return ble_adv_start(adv_req_min, adv_req_max, adv_req_chan_map);
        }
        return 0;                           /* takes effect on the next start */
    }
    /* Update without stopping: a stop/start would reset the advertising cadence
     * on every payload change and make an interval sweep meaningless. */
    return bt_le_adv_update_data(adv_ad, adv_ad_count, NULL, 0);
}

int ble_adv_start(uint16_t interval_min, uint16_t interval_max, uint8_t chan_map)
{
    struct bt_le_adv_param p = *BT_LE_ADV_NCONN;
    p.interval_min = interval_min;
    p.interval_max = interval_max;
    ARG_UNUSED(chan_map);   /* Zephyr exposes the channel map only via HCI or
                             * CONFIG_BT_CTLR_ADV_EXT; see the note in README. */

    /* Remember the request even if it cannot be honoured yet. */
    adv_req_min = interval_min;
    adv_req_max = interval_max;
    adv_req_chan_map = chan_map;
    adv_requested = true;

    if (adv_ad_count == 0u) {
        /* No payload yet. Not an error: ble_adv_set() will start us. */
        LOG_INF("advertising deferred until a payload arrives");
        return 0;
    }

    if (adv_running) {
        (void)bt_le_adv_stop();
        adv_running = false;
    }
    LOG_INF("bt_le_adv_start: %u element(s), interval %u..%u", adv_ad_count,
            interval_min, interval_max);
    for (uint8_t k = 0; k < adv_ad_count; k++) {
        LOG_INF("  ad[%u] type 0x%02X len %u", k, adv_ad[k].type,
                adv_ad[k].data_len);
    }
    int err = bt_le_adv_start(&p, adv_ad, adv_ad_count, NULL, 0);
    if (err) {
        LOG_ERR("bt_le_adv_start FAILED: %d", err);
        return err;
    }
    LOG_INF("bt_le_adv_start ok");
    adv_running = true;
    LOG_INF("advertising: interval %u..%u", interval_min, interval_max);
    return 0;
}

int ble_adv_stop(void)
{
    adv_requested = false;      /* else the next payload would restart us */
    if (!adv_running) {
        return 0;
    }
    adv_running = false;
    return bt_le_adv_stop();
}

bool ble_adv_running(void) { return adv_running; }

const struct ble_scan_stats *ble_scan_stats(void) { return &stats; }
```

## src/ble_scan.h
```c
/**
 * @file ble_scan.h
 * @brief BLE observer: every advertising report, raw and unparsed.
 *
 * The instrument's defining property. It does NOT parse advertising data, does
 * NOT filter by manufacturer, and does NOT filter duplicates. It captures the raw
 * AD bytes and hands them to the host.
 *
 * Each of those is deliberate:
 *
 * - **No parsing.** The Pi already has a decoder. A second one here could
 *   disagree with it, and a peer that agrees with the host's bug is worse than
 *   no peer at all. Raw bytes let the host assert byte equality against exactly
 *   what it transmitted.
 * - **No duplicate filtering** (`BT_LE_SCAN_OPT_NONE`). The coordination firmware
 *   uses `BT_LE_SCAN_OPT_FILTER_DUPLICATE`, which suppresses a repeat of an
 *   identical payload. A suppressed duplicate is indistinguishable from a lost
 *   packet, so filtering makes delivery ratio unmeasurable.
 * - **Passive by default.** Active scanning transmits scan requests, spending
 *   airtime and perturbing the very coexistence being measured.
 */

#ifndef BLE_SCAN_H_
#define BLE_SCAN_H_

#include <stdbool.h>
#include <stdint.h>

#define BLE_MAX_AD_LEN      31u

struct ble_report {
    uint64_t timestamp_us;      /* capture instant, board clock */
    int8_t   rssi;
    uint8_t  addr[6];           /* little-endian, as it appears on the wire */
    uint8_t  addr_type;
    uint8_t  adv_type;
    uint8_t  len;
    uint8_t  data[BLE_MAX_AD_LEN];
};

extern struct k_msgq ble_report_queue;

struct ble_scan_stats {
    uint32_t reports;
    uint32_t queue_dropped;     /* consumer too slow -- NOT radio loss */
    uint32_t oversize;
};

int  ble_scan_init(void);
int  ble_scan_start(uint16_t interval, uint16_t window, bool active);
int  ble_scan_stop(void);

/** @brief Advertise @p data verbatim. Replaces the payload without stopping. */
int  ble_adv_set(const uint8_t *data, uint8_t len);
int  ble_adv_start(uint16_t interval_min, uint16_t interval_max, uint8_t chan_map);
int  ble_adv_stop(void);

const struct ble_scan_stats *ble_scan_stats(void);

#endif /* BLE_SCAN_H_ */
```

## src/proto.c
```c
#include "proto.h"

#include <string.h>

/*
 * ONE parser, dispatching on the type byte.
 */

/* CRC-16/CCITT-FALSE: poly 0x1021, init 0xFFFF, no reflection, no final xor. */
uint16_t proto_crc16(const uint8_t *data, size_t len)
{
    uint16_t crc = 0xFFFFu;

    for (size_t i = 0; i < len; i++) {
        crc ^= (uint16_t)((uint16_t)data[i] << 8);
        for (unsigned b = 0; b < 8u; b++) {
            crc = (crc & 0x8000u) ? (uint16_t)((crc << 1) ^ 0x1021u)
                                  : (uint16_t)(crc << 1);
        }
    }
    return crc;
}

void proto_parser_init(struct proto_parser *p, proto_frame_cb cb, void *ctx)
{
    memset(p, 0, sizeof(*p));
    p->cb = cb;
    p->ctx = ctx;
    p->state = PROTO_WAIT_SOF;
}

void proto_parser_reset(struct proto_parser *p)
{
    p->state = PROTO_WAIT_SOF;
    p->received_len = 0;
    p->expected_len = 0;
}

void proto_parser_timeout(struct proto_parser *p)
{
    if (p->state != PROTO_WAIT_SOF) {
        p->stats.timeouts++;
        proto_parser_reset(p);
    }
}

/** Expected payload length for a type, or 0xFFFF if the type is unknown. */
static uint16_t max_len_for(uint8_t type)
{
    switch (type) {
    case PROTO_T_NETWORK:     return PROTO_NETWORK_MAX_LEN;
    case PROTO_T_ALGORITHM:   return PROTO_ALGORITHM_LEN;
    case PROTO_T_DISTURBANCE: return PROTO_DISTURBANCE_LEN;
    case PROTO_T_CONTROL:     return PROTO_CONTROL_LEN;
    case PROTO_T_RADIO:       return PROTO_RADIO_LEN;
    case PROTO_T_PING:        return PROTO_PING_LEN;
    case PROTO_T_STATS_REQ:   return PROTO_STATS_REQ_LEN;
    case PROTO_T_ADV_TX:      return PROTO_MAX_PAYLOAD;   /* AD bytes, variable */
    default:                  return 0xFFFFu;
    }
}

static void deliver(struct proto_parser *p)
{
    p->stats.frames_ok++;
    if (p->cb != NULL) {
        p->cb(p->type, p->payload, p->received_len, p->ctx);
    }
}

void proto_feed(struct proto_parser *p, const uint8_t *data, size_t len)
{
    for (size_t i = 0; i < len; i++) {
        const uint8_t byte = data[i];
        p->stats.bytes_in++;

        switch (p->state) {

        case PROTO_WAIT_SOF:
            if (byte == PROTO_SOF) {
                p->state = PROTO_WAIT_TYPE;
            }
            /* Anything else is inter-frame noise: drop it silently. Counting it
             * would make normal start-up look like an error, since the Pi may
             * open the port mid-frame. */
            break;

        case PROTO_WAIT_TYPE: {
            uint16_t cap = max_len_for(byte);
            if (cap == 0xFFFFu) {
                /* Unknown type. Do NOT assume this byte was a stray SOF and
                 * restart here -- resync from the next SOF instead. */
                p->stats.resyncs++;
                p->state = PROTO_WAIT_SOF;
            } else {
                p->type = byte;
                p->state = PROTO_WAIT_LEN_LO;
            }
            break;
        }

        case PROTO_WAIT_LEN_LO:
            p->expected_len = byte;
            p->state = PROTO_WAIT_LEN_HI;
            break;

        case PROTO_WAIT_LEN_HI: {
            p->expected_len |= (uint16_t)((uint16_t)byte << 8);
            uint16_t cap = max_len_for(p->type);

            if (p->expected_len > cap || p->expected_len > PROTO_MAX_PAYLOAD) {
                p->stats.len_errors++;
                p->stats.resyncs++;
                p->state = PROTO_WAIT_SOF;
            } else if (p->expected_len == 0u) {
                /* Zero-length frames are legal (PING). Straight to the CRC. */
                p->received_len = 0;
                p->state = PROTO_WAIT_CRC_LO;
            } else {
                p->received_len = 0;
                p->state = PROTO_WAIT_PAYLOAD;
            }
            break;
        }

        case PROTO_WAIT_PAYLOAD:
            p->payload[p->received_len++] = byte;
            /* The prototype reset the state after EVERY payload byte, not only
             * when the payload completed, so nothing longer than one byte could
             * ever be received. The guard belongs here. */
            if (p->received_len >= p->expected_len) {
                p->state = PROTO_WAIT_CRC_LO;
            }
            break;

        case PROTO_WAIT_CRC_LO:
            p->crc_rx = byte;
            p->state = PROTO_WAIT_CRC_HI;
            break;

        case PROTO_WAIT_CRC_HI: {
            p->crc_rx |= (uint16_t)((uint16_t)byte << 8);

            /* CRC covers TYPE, LEN and PAYLOAD -- rebuild that span. */
            uint8_t head[3];
            head[0] = p->type;
            proto_st_u16(&head[1], p->expected_len);

            uint16_t crc = proto_crc16(head, sizeof(head));
            /* Continue the CRC over the payload without a scratch copy. */
            for (uint16_t k = 0; k < p->received_len; k++) {
                crc ^= (uint16_t)((uint16_t)p->payload[k] << 8);
                for (unsigned b = 0; b < 8u; b++) {
                    crc = (crc & 0x8000u) ? (uint16_t)((crc << 1) ^ 0x1021u)
                                          : (uint16_t)(crc << 1);
                }
            }

            if (crc == p->crc_rx) {
                deliver(p);
            } else {
                p->stats.crc_errors++;
                p->stats.resyncs++;
            }
            p->state = PROTO_WAIT_SOF;
            break;
        }

        default:
            p->state = PROTO_WAIT_SOF;
            break;
        }
    }
}

size_t proto_build(uint8_t *out, size_t out_size, uint8_t type,
                   const uint8_t *payload, uint16_t len)
{
    if (len > PROTO_MAX_PAYLOAD) {
        return 0;
    }
    const size_t total = (size_t)len + PROTO_OVERHEAD;
    if (out_size < total) {
        return 0;
    }

    out[0] = PROTO_SOF;
    out[1] = type;
    proto_st_u16(&out[2], len);
    if (len > 0u && payload != NULL) {
        memcpy(&out[4], payload, len);
    }

    const uint16_t crc = proto_crc16(&out[1], (size_t)len + 3u);
    proto_st_u16(&out[4 + len], crc);
    return total;
}
```

## src/proto.h
```c
/**
 * @file proto.h
 * @brief Framed binary protocol between the Raspberry Pi and this board.
 *
 * Frame layout, all multi-byte fields LITTLE-endian:
 *
 *     +------+------+--------+-----------------+--------+
 *     | SOF  | TYPE | LEN:2  | PAYLOAD[LEN]    | CRC:2  |
 *     | 0x7E |      |        |                 |        |
 *     +------+------+--------+-----------------+--------+
 *                   \___________________________/
 *                     CRC-16/CCITT-FALSE covers
 *                     TYPE, LEN and PAYLOAD
 *
 * Three properties this buys, none of which a bare type-byte-plus-length has:
 *
 * 1. A dedicated start-of-frame byte. With binary payloads, any payload byte can
 *    equal a type code, so using the type as the sync marker means a corrupted
 *    stream re-synchronises inside a payload and silently accepts garbage.
 * 2. A CRC. Resync after corruption is then *detected* rather than hoped for, and
 *    the error is counted instead of applied as configuration.
 * 3. One flat parser for every frame type. 
 *
 * Endianness is little to match the rest of the platform: the BLE payload
 * (`vertex/wire/codec.py`), `custom_data_type` in the coordination firmware, and
 * the Cortex-M itself are all little-endian. Two endiannesses in one system is a
 * standing invitation to a field that reads plausibly and is wrong.
 */

#ifndef PROTO_H_
#define PROTO_H_

#include <stdbool.h>
#include <stddef.h>
#include <stdint.h>

#define PROTO_SOF               0x7Eu
#define PROTO_MAX_PAYLOAD       256u
#define PROTO_OVERHEAD          6u      /* SOF + TYPE + LEN(2) + CRC(2) */
#define PROTO_MAX_FRAME         (PROTO_MAX_PAYLOAD + PROTO_OVERHEAD)

/* Pi -> board */
#define PROTO_T_NETWORK         0x4Eu   /* 'N' */
#define PROTO_T_ALGORITHM       0x41u   /* 'A' -- note: 'A', not 0x61 ('a') */
#define PROTO_T_DISTURBANCE     0x44u   /* 'D' */
#define PROTO_T_CONTROL         0x53u   /* 'S' */
#define PROTO_T_ADV_TX          0x54u   /* 'T' -- advertise these AD bytes verbatim */
#define PROTO_T_RADIO           0x52u   /* 'R' -- set adv/scan parameters */
#define PROTO_T_PING            0x50u   /* 'P' */
#define PROTO_T_STATS_REQ       0x51u   /* 'Q' -- read counters */

/* board -> Pi */
#define PROTO_T_ADV_REPORT      0x72u   /* 'r' -- one advertising report */
#define PROTO_T_STATE           0x78u   /* 'x' -- one control step */
#define PROTO_T_TXAT            0x74u   /* 't' -- payload reached the controller */
#define PROTO_T_ACK             0x6Bu   /* 'k' */
#define PROTO_T_ERR             0x65u   /* 'e' */
#define PROTO_T_PONG            0x70u   /* 'p' */
#define PROTO_T_STATS           0x71u   /* 'q' -- counter dump */

/* Payload sizes for the fixed-length types. Network is variable. */
#define PROTO_MAX_NEIGHBORS     16u
#define PROTO_NETWORK_MIN_LEN   2u      /* enabled + node_id, zero neighbours */
#define PROTO_NETWORK_MAX_LEN   (PROTO_NETWORK_MIN_LEN + PROTO_MAX_NEIGHBORS)
#define PROTO_ALGORITHM_LEN     40u     /* 10 x int32 */
#define PROTO_DISTURBANCE_LEN   29u     /* 1 x uint8 + 7 x int32 */
#define PROTO_CONTROL_LEN       11u     /* run flag + uint32 seed + uint48 epoch */
#define PROTO_RADIO_LEN         9u
#define PROTO_PING_LEN          0u
#define PROTO_STATS_REQ_LEN     0u

enum proto_state {
    PROTO_WAIT_SOF = 0,
    PROTO_WAIT_TYPE,
    PROTO_WAIT_LEN_LO,
    PROTO_WAIT_LEN_HI,
    PROTO_WAIT_PAYLOAD,
    PROTO_WAIT_CRC_LO,
    PROTO_WAIT_CRC_HI,
};

struct proto_stats {
    uint32_t frames_ok;
    uint32_t crc_errors;
    uint32_t len_errors;
    uint32_t resyncs;       /* bad type/length or failed CRC: frame discarded */
    uint32_t timeouts;      /* frames abandoned because the line went idle */
    uint32_t bytes_in;
};

/**
 * @brief Called once per validated frame. Payload is only valid for the call.
 */
typedef void (*proto_frame_cb)(uint8_t type, const uint8_t *payload,
                               uint16_t len, void *ctx);

struct proto_parser {
    enum proto_state state;
    uint8_t  type;
    uint16_t expected_len;
    uint16_t received_len;
    uint16_t crc_rx;
    uint8_t  payload[PROTO_MAX_PAYLOAD];
    proto_frame_cb cb;
    void *ctx;
    struct proto_stats stats;
};

void     proto_parser_init(struct proto_parser *p, proto_frame_cb cb, void *ctx);
void     proto_parser_reset(struct proto_parser *p);
void     proto_feed(struct proto_parser *p, const uint8_t *data, size_t len);
uint16_t proto_crc16(const uint8_t *data, size_t len);

/**
 * @brief True while a frame is partially received.
 *
 * The transport uses this to decide whether an idle line means "nothing to do"
 * or "a frame was cut short" -- see :c:func:`proto_parser_timeout`.
 */
static inline bool proto_parser_in_frame(const struct proto_parser *p)
{
    return p->state != PROTO_WAIT_SOF;
}

/**
 * @brief Abandon a partially received frame. Call when the line has been idle.
 *
 * Necessary because a mid-payload SOF byte is deliberately NOT treated as a new
 * frame: payloads are binary and contain every byte value, so honouring an
 * embedded 0x7E would corrupt every frame that happens to carry one.
 *
 * Recommended: 100 ms of silence while ``proto_parser_in_frame()``. Truncation on
 * USB CDC essentially only happens when the host dies or reopens the port
 * mid-write, so the timeout is a recovery path rather than a hot one.
 */
void     proto_parser_timeout(struct proto_parser *p);

/**
 * @brief Build a frame into @p out.
 * @return total bytes written, or 0 if @p out is too small or the payload too big.
 */
size_t proto_build(uint8_t *out, size_t out_size, uint8_t type,
                   const uint8_t *payload, uint16_t len);

/* Little-endian field accessors. Byte-wise, so they are alignment-safe:
 * a payload sits at an arbitrary offset in a buffer and a cast would fault
 * on a strict-alignment target. */
static inline uint16_t proto_ld_u16(const uint8_t *p)
{
    return (uint16_t)((uint16_t)p[0] | ((uint16_t)p[1] << 8));
}

static inline uint32_t proto_ld_u32(const uint8_t *p)
{
    return ((uint32_t)p[0]) | ((uint32_t)p[1] << 8) |
           ((uint32_t)p[2] << 16) | ((uint32_t)p[3] << 24);
}

static inline int32_t proto_ld_i32(const uint8_t *p)
{
    return (int32_t)proto_ld_u32(p);
}

static inline void proto_st_u16(uint8_t *p, uint16_t v)
{
    p[0] = (uint8_t)(v & 0xFFu);
    p[1] = (uint8_t)(v >> 8);
}

static inline void proto_st_u32(uint8_t *p, uint32_t v)
{
    p[0] = (uint8_t)(v & 0xFFu);
    p[1] = (uint8_t)((v >> 8) & 0xFFu);
    p[2] = (uint8_t)((v >> 16) & 0xFFu);
    p[3] = (uint8_t)((v >> 24) & 0xFFu);
}

static inline void proto_st_u64(uint8_t *p, uint64_t v)
{
    for (unsigned i = 0; i < 8u; i++) {
        p[i] = (uint8_t)((v >> (8u * i)) & 0xFFu);
    }
}

#endif /* PROTO_H_ */
```

## src/uart_link.h
```c
/**
 * @file uart_link.h
 * @brief Framed UART transport: async RX into a ring buffer, queued TX.
 *
 * Splits cleanly from proto.c: this file owns the hardware and the concurrency,
 * proto.c owns the bytes. Neither needs to know the other's difficulties.
 */

#ifndef UART_LINK_H_
#define UART_LINK_H_

#include <stdint.h>
#include <stddef.h>

#include "proto.h"

struct uart_link_stats {
    uint32_t rx_overrun_bytes;  /* ring buffer full: bytes dropped before parsing */
    uint32_t tx_dropped;        /* TX queue full: frames never sent */
    uint32_t tx_frames;
    uint32_t rx_stopped;        /* bus errors (framing/parity/overrun) */

    /* Diagnostic for the one silent misconfiguration this driver can suffer.
     *
     * CONFIG_UART_0_NRF_HW_ASYNC=y 
     * CONFIG_UART_0_NRF_HW_ASYNC_TIMER. 
     *
     */
    uint32_t rx_partial_flushes;
    uint32_t rx_full_flushes;
};

int  uart_link_init(proto_frame_cb cb, void *ctx);

/** @brief Queue one frame. Non-blocking; drops and counts when the queue is full. */
int  uart_link_send(uint8_t type, const uint8_t *payload, uint16_t len);

const struct uart_link_stats *uart_link_stats(void);
const struct proto_stats     *uart_link_proto_stats(void);

#endif /* UART_LINK_H_ */
```
