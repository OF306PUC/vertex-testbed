## CMakeLists.txt
```
cmake_minimum_required(VERSION 3.20.0)

find_package(Zephyr REQUIRED HINTS $ENV{ZEPHYR_BASE})
project(NONE)

# NORDIC SDK APP START
target_sources(app PRIVATE
  src/main.c
  src/broadcaster.c
  src/observer.c
  src/agent.c
  src/coordination_task.c
    src/microgrid_task.c
  src/prng.c
  src/air_wire.c
  src/proto.c
  src/uart_link.c
  src/control.c
  src/report.c
)

# NORDIC SDK APP END
zephyr_library_include_directories(.)
```

## prj.conf
```kconfig
# ─────────────────────────────────────────────────────────────────────────────
# Coordination agent: the control law runs here; the Pi relays.
#
#   Pi ──UART N/A/D/S/R──► this board runs the law ──BLE──► neighbours
#      ◄──UART STATE──────
# ─────────────────────────────────────────────────────────────────────────────

# ── uart0 belongs to the protocol, and nothing else ──────────────────────────
# Both of these default to ON and write to uart0. Interleaved text corrupts
# binary frames in a way that looks like a link fault: the parser resynchronises
# on the next SOF and reports CRC errors, so the symptom points at the cable.
CONFIG_UART_CONSOLE=n
CONFIG_LOG_BACKEND_UART=n

# Logging over RTT, not UART. Previously CONFIG_LOG=n, which compiled every
# LOG_INF/LOG_WRN in this firmware to nothing -- including the scan totals and
# the selected TX power, which are the only place those numbers surface.
CONFIG_LOG=y
CONFIG_LOG_MODE_DEFERRED=y
CONFIG_USE_SEGGER_RTT=y
CONFIG_LOG_BACKEND_RTT=y
CONFIG_RTT_CONSOLE=y

# ── UART: UARTE0 through the async (DMA) API ─────────────────────────────────
CONFIG_SERIAL=y
CONFIG_UART_ASYNC_API=y

# Hardware byte counting, and the timer it needs. NOT optional, and its absence
# fails silently: without it the UARTE driver cannot tell how many bytes are in
# the DMA buffer before that buffer fills, so the RX idle timeout never fires and
# a short frame sits in DMA indefinitely. Configuration frames are all short, so
# the board would accept nothing and look like a dead link. The loopback peers
# have carried this since direction A; this firmware did not.
CONFIG_UART_0_NRF_HW_ASYNC=y
CONFIG_UART_0_NRF_HW_ASYNC_TIMER=2

CONFIG_RING_BUFFER=y

# ── Bluetooth ────────────────────────────────────────────────────────────────
CONFIG_BT=y
CONFIG_BT_DEVICE_NAME="LABCTRL"
CONFIG_BT_BROADCASTER=y             # broadcaster.c: publish this agent's vstate
CONFIG_BT_OBSERVER=y                # observer.c: receive the neighbours'

# ── board support ────────────────────────────────────────────────────────────
CONFIG_DK_LIBRARY=y                 # dk_set_led: the status blink in main.c

# ── stacks ───────────────────────────────────────────────────────────────────
CONFIG_MAIN_STACK_SIZE=2048
CONFIG_SYSTEM_WORKQUEUE_STACK_SIZE=2048
CONFIG_HEAP_MEM_POOL_SIZE=2048

# ── transmit power ───────────────────────────────────────────────────────────
# Without this the vendor command broadcaster.c uses (0xfc0e, Write Tx Power
# Level) is NOT compiled into the SoftDevice Controller: it answers status 0x01
# "Unknown HCI Command", set_tx_power() fails with err -5, and the board
# advertises at the controller default of 0 dBm instead of TX_POWER_LEVEL_BLE.
#
# That is not hypothetical -- it is what every run before 2026-08-26 did. The
# failure was logged, but to RTT, so nothing recorded it and no delivery figure
# was ever attributed to it.
#
# Verified after adding this, with test/nrf/txpower on an nRF52840:
#     requested +8 dBm: GRANTED +8 dBm
#     read back:  advertising channel reports +8 dBm
#     ladder: -40..+8 granted exactly; +10 and +20 clamp to +8
#
# If this line is ever removed, transmit power silently reverts to 0 dBm. Check
# with test/nrf/txpower rather than assuming.
CONFIG_BT_CTLR_TX_PWR_DYNAMIC_CONTROL=y
```

## src/main.c
```c
/**
 * @file main.c
 * @brief Wiring and the two run loops.
 *
 * Owns the agent and hands it to the modules that need it: the control plane
 * through uart_link's `ctx`, the observer through observer_bind(). One owner makes
 * the initialisation order visible instead of hiding it behind a linker symbol.
 *
 * Two loops, both semaphore-driven off a k_timer:
 *
 *   dynamics_thread (P5, every `dt` ms)     -- one control step, then republish
 *   network_thread  (P7, every `clock` ms)  -- absorb neighbour data, send STATE
 *
 * `coordination_mutex` guards the agent between them. The Bluetooth RX thread is
 * deliberately not a third writer: the observer hands its findings over through a
 * message queue and the network thread applies them under the mutex.
 */

#include <string.h>

#include <dk_buttons_and_leds.h>
#include <zephyr/bluetooth/bluetooth.h>
#include <zephyr/bluetooth/gap.h>
#include <zephyr/kernel.h>
#include <zephyr/logging/log.h>

#include <math.h>

#include "agent.h"
#include "broadcaster.h"
#include "common.h"
#include "control.h"
#include "coordination_task.h"
#include "observer.h"
#include "report.h"
#include "air_wire.h"
#include "uart_link.h"

LOG_MODULE_REGISTER(Module_Main, LOG_LEVEL_INF);

#define LED_STATUS                     DK_LED1
#define BLINK_OK_MS                    1000
#define BLINK_FAULT_MS                 100    /* fast blink: no control plane */

#define APP_STACK_SIZE                 3072
#define THREAD_SLOW_NETWORK_PRIORITY   7
#define THREAD_FAST_DYNAMICS_PRIORITY  5

/** Idle wake-up period while stopped. A safety net only: control.c wakes this
 *  thread directly when a CONTROL frame lands, so a trigger is not waited for at
 *  this granularity. */
#define IDLE_POLL_MS                   1000

/**
 * The agent. Single owner; every other module receives a pointer.
 */
static struct agent agent;

static struct k_timer dynamics_timer;
static struct k_timer network_timer;
static struct k_mutex coordination_mutex;
static struct k_sem   dynamics_sem;
static struct k_sem   network_sem;

static void leds_init(void);
static void bt_init(void);
static void dynamics_thread(void);
static void network_fetching_thread(void);
static void dynamics_timer_cb(struct k_timer *dummy);
static void network_timer_cb(struct k_timer *dummy);
static void on_control_frame(void);
static void absorb_neighbors(const neighbor_info_type *info);

K_THREAD_DEFINE(dynamics_thread_id, APP_STACK_SIZE,
                dynamics_thread, NULL, NULL, NULL,
                THREAD_FAST_DYNAMICS_PRIORITY, 0, 0);

K_THREAD_DEFINE(thread_coordination_id, APP_STACK_SIZE, network_fetching_thread,
                NULL, NULL, NULL, THREAD_SLOW_NETWORK_PRIORITY, 0, 0);

int main(void)
{
    int blink_status = 0;
    uint32_t blink_ms = BLINK_OK_MS;

    agent_init(&agent);
    observer_bind(&agent);
    leds_init();
    bt_init();

    k_mutex_init(&coordination_mutex);
    k_sem_init(&dynamics_sem, 0, 1);
    k_sem_init(&network_sem,  0, 1);
    k_timer_init(&dynamics_timer, dynamics_timer_cb, NULL);
    k_timer_init(&network_timer,  network_timer_cb,  NULL);

    control_set_trigger_hook(on_control_frame);
    if (uart_link_init(control_on_frame, &agent)) {
        LOG_ERR("UART link init failed -- no control plane");
        blink_ms = BLINK_FAULT_MS;
    }

    while (1) {
        dk_set_led(LED_STATUS, (++blink_status) % 2);
        k_sleep(K_MSEC(blink_ms));
    }
}

static void leds_init(void)
{
    int err = dk_leds_init();
    if (err) {
        LOG_ERR("Status LED failed to start (err %d)", err);
        return;
    }
    LOG_INF("Status LED started");
}

static void bt_init(void)
{
    int err = bt_enable(NULL);
    if (err) {
        LOG_ERR("Bluetooth failed to start (err %d)", err);
        return;
    }
    LOG_INF("Bluetooth started");
}

static void dynamics_timer_cb(struct k_timer *dummy)
{
    ARG_UNUSED(dummy);
    k_sem_give(&dynamics_sem);
}

static void network_timer_cb(struct k_timer *dummy)
{
    ARG_UNUSED(dummy);
    k_sem_give(&network_sem);
}

/**
 * Wake the network thread now, from control.c's frame callback.
 *
 * Without this the thread learns of a trigger only when its idle poll next fires,
 * so the first control step lands anywhere in a 0..IDLE_POLL_MS window. 
 */
static void on_control_frame(void)
{
    k_sem_give(&network_sem);
}

/**
 * Build the packet to advertise. Caller holds the mutex.
 */
static state_packet_type on_air_packet(int64_t uptime_us)
{
    uint64_t tx_time_us = 0u;
    if (agent.params.epoch_us != 0u) {
        int64_t elapsed_us = uptime_us - agent.vars.time_us;
        if (elapsed_us < 0) {
            elapsed_us = 0;
        }
        tx_time_us = agent.params.epoch_us + (uint64_t)elapsed_us;
    }
    /* How many coordinates go on the air follows from the law the manifest
     * selected, so the frame version is decided in one place and cannot
     * disagree with what the board is actually integrating. */
    const bool two = (agent.params.law != LAW_FINITE_TIME_ADAPTIVE);
    return (state_packet_type){
        .node           = agent.params.node_id,
        .enabled        = agent.params.enabled,
        .disturbance_on = agent.params.disturbance.active,
        .seq            = agent.vars.tx_seq,
        .vstate         = agent.vars.vstate,
        .vstate_q       = two ? (int32_t)lrintf(agent.vars.mg.zQ * SCALE_FACTOR)
                              : 0,
        .coords         = two ? 2u : 1u,
        .tx_time_us     = tx_time_us,
    };
}

/**
 * --- CONTROL LOOP --- every `dt`
 *
 * Absorb whatever the observer has heard, then take one step. 
 *
 */
static void dynamics_thread(void)
{
    static neighbor_info_type neighbor_info;

    while (1) {
        k_sem_take(&dynamics_sem, K_FOREVER);

        /* Non-blocking: a period with no new neighbour data is normal. */
        const bool fresh_data =
            k_msgq_get(&custom_observer_msg_queue, &neighbor_info, K_NO_WAIT) == 0;

        k_mutex_lock(&coordination_mutex, K_FOREVER);
        if (agent.params.running && agent.params.enabled) {
            if (fresh_data) {
                absorb_neighbors(&neighbor_info);
            }
            discrete_step(&agent);
        }
        k_mutex_unlock(&coordination_mutex);
    }
}

/**
 * Fold one observer snapshot into the agent. Caller holds the mutex.
 */
static void absorb_neighbors(const neighbor_info_type *info)
{
    if (!agent.params.enabled) {
        return;
    }
    memcpy(agent.vars.neighbor_vstates, info->vstates, sizeof(info->vstates));
    memcpy(agent.vars.neighbor_vstates_q, info->vstates_q,
           sizeof(info->vstates_q));
    memcpy(agent.params.neighbors_enabled, info->enabled, sizeof(info->enabled));
    memcpy(agent.vars.neighbor_seq, info->seq, sizeof(info->seq));
    memcpy(agent.vars.neighbor_rssi, info->rssi, sizeof(info->rssi));

    uint8_t seen = 0;
    for (uint8_t i = 0; i < agent.params.n_neighbors; i++) {
        const bool heard = (info->heard & (1u << i)) != 0u;
        agent.params.available_neighbors[i] = heard;
        if (heard) {
            seen++;
        }
    }
    agent.params.all_neighbors_observed = (seen == agent.params.n_neighbors);
}

/**
 * --- NETWORK / REPORTING LOOP ---
 * Driven by network_timer at `clock` ms. Supports N consecutive runs without a
 * reboot: the trigger comes back through a CONTROL frame.
 */
static void network_fetching_thread(void)
{
    static struct agent log_data_copy;
    static bool was_running = false;
    /* Publish on every `publish_every`-th tick of this loop, which runs at `dt`. */
    static uint32_t publish_every = 1u;
    static uint32_t tick = 0u;

    while (1) {
        /* Idle fallback so a new trigger is noticed while the timer is stopped. */
        k_sem_take(&network_sem, K_MSEC(IDLE_POLL_MS));

        k_mutex_lock(&coordination_mutex, K_FOREVER);
        const bool running    = agent.params.running;
        const bool first_time = agent.params.first_time_running;
        k_mutex_unlock(&coordination_mutex);

        if (!running) {
            if (was_running) {
                k_timer_stop(&dynamics_timer);
                k_timer_stop(&network_timer);
                broadcaster_stop();
                observer_stop();        /* also purges the message queue */
                was_running = false;
            }
            continue;
        }

        if (first_time) {
            /* NETWORK/ALGORITHM/DISTURBANCE arrive before CONTROL, so these
             * fields are stable by now. */
            k_mutex_lock(&coordination_mutex, K_FOREVER);
            const state_packet_type initial_data =
                on_air_packet(k_ticks_to_us_floor64(k_uptime_ticks()));
            const int32_t dt_ms    = agent.params.dt;
            const int32_t clock_ms = agent.params.clock;
            agent.params.first_time_running = false;
            k_mutex_unlock(&coordination_mutex);

            broadcaster_init(&initial_data);
            observer_init();
            k_timer_start(&dynamics_timer, K_MSEC(0), K_MSEC(dt_ms));
            /* Both loops tick at `dt`. Publishing is every `publish_every`-th tick
             * of this one, so `clock` still sets the publish period. */
            k_timer_start(&network_timer, K_MSEC(dt_ms), K_MSEC(dt_ms));
            publish_every = (dt_ms > 0) ? (uint32_t)(clock_ms / dt_ms) : 1u;
            if (publish_every == 0u) {
                publish_every = 1u;     /* clock < dt: publish every step */
            }
            tick = 0u;
            was_running = true;
        }

        k_mutex_lock(&coordination_mutex, K_FOREVER);
        /* A real snapshot: struct agent holds its neighbour arrays inline, where
         * the struct this replaced held pointers. */
        memcpy(&log_data_copy, &agent, sizeof(agent));
        k_mutex_unlock(&coordination_mutex);

        /* REPORT every `dt`, matching a Pi agent, which logs a sample per control
         * step. */
        report_state(&log_data_copy);

        if (++tick >= publish_every) {
            tick = 0u;
            state_packet_type pkt;
            bool publish = false;

            k_mutex_lock(&coordination_mutex, K_FOREVER);
            if (agent.params.running && agent.params.enabled) {
                agent.vars.tx_seq++;
                pkt = on_air_packet(k_ticks_to_us_floor64(k_uptime_ticks()));
                publish = true;
            }
            k_mutex_unlock(&coordination_mutex);

            /* Outside the mutex: an HCI round trip must not block the control
             * thread, which needs this lock every `dt`. */
            if (publish) {
                (void)broadcaster_update(&pkt);
            }
        }
    }
}
```

## src/agent.c
```c
/**
 * @file agent.c
 * @brief Configuration frames -> struct agent. Payload formats live in agent.h.
 */

#include "agent.h"
#include "microgrid_task.h"

#include <string.h>

#include "prng.h"

void agent_init(struct agent *a)
{
    memset(a, 0, sizeof(*a));
    a->params.dt    = 200;      /* ms */
    a->params.clock = 1000;     /* ms */
    a->params.disturbance.samples = 1000;
}

int8_t agent_neighbor_index(const struct agent *a, uint8_t node)
{
    for (uint8_t i = 0; i < a->params.n_neighbors; i++) {
        if (a->params.neighbors_id[i] == node) {
            return (int8_t)i;
        }
    }
    return -1;
}

static int apply_network(struct agent *a, const uint8_t *d, uint16_t len)
{
    /* Two mandatory bytes: enabled, node_id. */
    if (len < PROTO_NETWORK_MIN_LEN) {
        return AGENT_ERR_LEN;
    }
    const uint16_t n = (uint16_t)(len - PROTO_NETWORK_MIN_LEN);
    if (n > AGENT_MAX_NEIGHBORS) {
        return AGENT_ERR_RANGE;
    }
    if (d[1] == 0u) {
        return AGENT_ERR_RANGE;         /* node id 0 is reserved */
    }

    /* Every configuration sequence re-declares the law. A MICROGRID frame
     * later in the same sequence upgrades it; nothing else can. */
    a->params.law = LAW_FINITE_TIME_ADAPTIVE;
    /* And the blocks that would let it be re-selected. Clearing the law but
     * keeping the bits would let a lone MG_IFACE frame commit a law over a
     * plant and an observer belonging to the previous run. */
    a->params.mg_blocks = 0u;
    a->params.enabled     = (d[0] == 1u);
    a->params.node_id     = d[1];
    a->params.n_neighbors = (uint8_t)n;

    for (uint16_t i = 0; i < n; i++) {
        a->params.neighbors_id[i] = d[i + PROTO_NETWORK_MIN_LEN];
    }
    /* Clear the tail so a shorter list cannot leave stale ids behind */
    for (uint16_t i = n; i < AGENT_MAX_NEIGHBORS; i++) {
        a->params.neighbors_id[i] = 0u;
    }
    return AGENT_OK;
}

static int apply_algorithm(struct agent *a, const uint8_t *d, uint16_t len)
{
    if (len != PROTO_ALGORITHM_LEN) {
        return AGENT_ERR_LEN;
    }
    const int32_t dt    = proto_ld_i32(&d[0]);
    const int32_t clock = proto_ld_i32(&d[4]);
    if (dt <= 0 || clock <= 0) {
        return AGENT_ERR_RANGE;         /* a zero period would spin the timer */
    }

    a->params.dt         = dt;
    a->params.clock      = clock;
    a->params.state_0    = proto_ld_i32(&d[8]);
    a->params.vstate_0   = proto_ld_i32(&d[12]);
    a->params.vartheta_0 = proto_ld_i32(&d[16]);
    a->params.counter_0  = proto_ld_i32(&d[20]);
    a->params.gain_ij    = proto_ld_i32(&d[24]);
    a->params.delta      = proto_ld_i32(&d[28]);
    a->params.eta        = proto_ld_i32(&d[32]);
    a->params.alpha      = proto_ld_i32(&d[36]);
    return AGENT_OK;
}

/**
 * @brief The microgrid parameters, and the law that uses them.
 *
 * Receiving this frame is what selects the second control family. There is
 * no other path to it: `apply_network` resets the law, so every
 * configuration sequence declares it afresh and a stale selection cannot
 * survive a reconfigure. A host that does not know about this type leaves
 * every board on the scalar law, which is the behaviour that predates it.
 */
/*
 * The microgrid configuration arrives as three frames, one per block, and is
 * committed by the last of them.
 *
 * Splitting it was forced by the transport: one frame was 121 bytes and the
 * board's USB CDC link carries 64. Keeping it committed-as-a-set is not
 * forced, it is chosen -- `law` is the field that takes the board out of the
 * scalar family, and a board running a law whose plant or observer never
 * arrived would integrate garbage while reporting normally.
 */
static int apply_mg_plant(struct agent *a, const uint8_t *d, uint16_t len)
{
    if (len != PROTO_MG_PLANT_LEN) {
        return AGENT_ERR_LEN;
    }
    struct microgrid_params *m = &a->params.microgrid;
    m->profile = d[0];
    m->kappa = proto_ld_i32(&d[1]);
    m->S1    = proto_ld_i32(&d[5]);
    m->S2    = proto_ld_i32(&d[9]);
    m->p_max = proto_ld_i32(&d[13]);
    m->q_max = proto_ld_i32(&d[17]);
    m->X0_P  = proto_ld_i32(&d[21]);
    m->X0_Q  = proto_ld_i32(&d[25]);

    if (m->kappa <= 0 || m->p_max <= 0 || m->q_max <= 0) {
        a->params.mg_blocks &= (uint8_t)~MG_BLOCK_PLANT;
        return AGENT_ERR_RANGE;         /* x = X/kappa, and a rating limiter */
    }
    a->params.mg_blocks |= MG_BLOCK_PLANT;
    return AGENT_OK;
}

static int apply_mg_virtual(struct agent *a, const uint8_t *d, uint16_t len)
{
    if (len != PROTO_MG_VIRTUAL_LEN) {
        return AGENT_ERR_LEN;
    }
    struct microgrid_params *m = &a->params.microgrid;
    m->T_o     = proto_ld_i32(&d[0]);
    m->alpha_0 = proto_ld_i32(&d[4]);
    m->delta_o = proto_ld_i32(&d[8]);
    m->kappa_o = proto_ld_i32(&d[12]);
    m->xi      = proto_ld_i32(&d[16]);
    m->c_0     = proto_ld_i32(&d[20]);
    m->b       = proto_ld_i32(&d[24]);
    m->rP      = proto_ld_i32(&d[28]);
    m->rQ      = proto_ld_i32(&d[32]);
    m->degree  = proto_ld_i32(&d[36]);
    m->z0_P    = proto_ld_i32(&d[40]);
    m->z0_Q    = proto_ld_i32(&d[44]);

    if (m->b == 0 && (m->rP != 0 || m->rQ != 0)) {
        /* An unpinned node was sent the reference. Not knowing it is the
         * hypothesis, so this is a configuration error and not a value to
         * quietly accept. */
        a->params.mg_blocks &= (uint8_t)~MG_BLOCK_VIRTUAL;
        return AGENT_ERR_RANGE;
    }
    a->params.mg_blocks |= MG_BLOCK_VIRTUAL;
    return AGENT_OK;
}

static int apply_mg_iface(struct agent *a, const uint8_t *d, uint16_t len)
{
    if (len != PROTO_MG_IFACE_LEN) {
        return AGENT_ERR_LEN;
    }
    if (d[0] != (uint8_t)LAW_MICROGRID_ADAPTIVE
        && d[0] != (uint8_t)LAW_MICROGRID_LC) {
        /* The scalar law is not selectable here: it is what you get by not
         * sending these frames, and accepting it would give two ways to mean
         * the same thing. */
        return AGENT_ERR_RANGE;
    }
    const uint8_t need = MG_BLOCK_PLANT | MG_BLOCK_VIRTUAL;
    if ((a->params.mg_blocks & need) != need) {
        /* Refused rather than queued: the host sends the three in order, so
         * arriving here without the others means one was lost or rejected,
         * and the honest outcome is that the board stays on the scalar law
         * and says so. */
        return AGENT_ERR_RANGE;
    }

    struct microgrid_params *m = &a->params.microgrid;
    m->terminal   = d[1];
    m->mu_max     = proto_ld_i32(&d[2]);
    m->gamma      = proto_ld_i32(&d[6]);
    m->eps        = proto_ld_i32(&d[10]);
    m->vartheta_0 = proto_ld_i32(&d[14]);
    m->T_c        = proto_ld_i32(&d[18]);
    m->beta_c     = proto_ld_i32(&d[22]);
    m->Phi        = proto_ld_i32(&d[26]);
    m->delta_c    = proto_ld_i32(&d[30]);
    m->adapt_band = proto_ld_i32(&d[34]);

    /* The commit. Nothing above this line changed which law runs. */
    a->params.law = (enum control_law)d[0];
    microgrid_reset(a);
    return AGENT_OK;
}


static int apply_disturbance(struct agent *a, const uint8_t *d, uint16_t len)
{
    if (len != PROTO_DISTURBANCE_LEN) {
        return AGENT_ERR_LEN;
    }
    const int32_t samples = proto_ld_i32(&d[25]);
    if (samples <= 0) {
        return AGENT_ERR_RANGE;         /* the counter wraps modulo this */
    }

    a->params.disturbance.active          = (d[0] == 1u);
    a->params.disturbance.sine_amplitude  = proto_ld_i32(&d[1]);
    a->params.disturbance.frequency       = proto_ld_i32(&d[5]);
    a->params.disturbance.phase           = proto_ld_i32(&d[9]);
    a->params.disturbance.noise_amplitude = proto_ld_i32(&d[13]);
    a->params.disturbance.noise_offset    = proto_ld_i32(&d[17]);
    a->params.disturbance.beta            = proto_ld_i32(&d[21]);
    a->params.disturbance.samples         = samples;
    return AGENT_OK;
}

static int apply_control(struct agent *a, const uint8_t *d, uint16_t len,
                         int64_t now_us)
{
    if (len != PROTO_CONTROL_LEN) {
        return AGENT_ERR_LEN;
    }

    if (d[0] == 1u) {
        a->params.seed                   = proto_ld_u32(&d[1]);
        /* uint48, little-endian, assembled byte by byte: there is no 6-byte load
         * in proto.h, and adding one there would put a radio-format width into
         * the serial header. */
        a->params.epoch_us = 0u;
        for (unsigned i = 0; i < 6u; i++) {
            a->params.epoch_us |= (uint64_t)d[5 + i] << (8u * i);
        }
        a->params.running                = true;
        a->params.first_time_running     = true;
        a->params.all_neighbors_observed = false;

        for (uint8_t i = 0; i < AGENT_MAX_NEIGHBORS; i++) {
            a->params.available_neighbors[i] = false;
            a->params.neighbors_enabled[i]   = false;
            a->vars.neighbor_vstates[i]      = 0;
            a->vars.neighbor_vstates_q[i]    = 0;
            a->vars.neighbor_seq[i]          = 0;
            a->vars.neighbor_rssi[i]         = 0;
        }

        a->vars.state    = a->params.state_0;
        a->vars.vstate   = a->params.vstate_0;
        a->vars.vartheta = a->params.vartheta_0;
        a->vars.counter  = a->params.counter_0;
        a->vars.time_us  = now_us;
        a->vars.tx_seq   = 0u;

        a->vars.state_f    = (float)a->params.state_0    * 1e-6f;
        a->vars.vstate_f   = (float)a->params.vstate_0   * 1e-6f;
        a->vars.vartheta_f = (float)a->params.vartheta_0 * 1e-6f;

        /* The trigger is what starts a run, so it is where initial conditions
         * are latched -- for whichever law is selected. Without this the
         * lines above put the SCALAR law's state_0 into the mirrors and the
         * microgrid integrators kept whatever the previous run left them,
         * so configuring once and triggering twice gave two different runs
         * and the first reported sample was the wrong law's value. */
        if (a->params.law != LAW_FINITE_TIME_ADAPTIVE) {
            microgrid_reset(a);
        }

        prng_seed((uint64_t)a->params.seed, (uint64_t)a->params.node_id);
    } else {
        a->params.running            = false;
        a->params.first_time_running = false;
    }
    return AGENT_OK;
}

int agent_parse_radio(const uint8_t *payload, uint16_t len,
                      struct radio_params *out)
{
    if (len != PROTO_RADIO_LEN) {
        return AGENT_ERR_LEN;
    }
    const uint16_t adv_min   = proto_ld_u16(&payload[0]);
    const uint16_t adv_max   = proto_ld_u16(&payload[2]);
    const uint16_t scan_int  = proto_ld_u16(&payload[4]);
    const uint16_t scan_win  = proto_ld_u16(&payload[6]);
    const uint8_t  flags     = payload[8];

    if (scan_int == 0u || scan_win > scan_int) {
        return AGENT_ERR_RANGE;
    }
    if (adv_min == 0u || adv_min > adv_max) {
        return AGENT_ERR_RANGE;
    }

    /* Written only after every check, so a rejected frame leaves the caller's
     * previous configuration intact rather than half-updated. */
    out->adv_min       = adv_min;
    out->adv_max       = adv_max;
    out->scan_interval = scan_int;
    out->scan_window   = scan_win;
    out->active_scan   = (flags & AGENT_RADIO_ACTIVE_SCAN) != 0u;
    out->advertising   = (flags & AGENT_RADIO_ADVERTISING) != 0u;
    return AGENT_OK;
}

int agent_apply_frame(struct agent *a, uint8_t type, const uint8_t *payload,
                      uint16_t len, int64_t now_us)
{
    switch (type) {
    case PROTO_T_NETWORK:     return apply_network(a, payload, len);
    case PROTO_T_ALGORITHM:   return apply_algorithm(a, payload, len);
    case PROTO_T_MG_PLANT:    return apply_mg_plant(a, payload, len);
    case PROTO_T_MG_VIRTUAL:  return apply_mg_virtual(a, payload, len);
    case PROTO_T_MG_IFACE:    return apply_mg_iface(a, payload, len);
    case PROTO_T_DISTURBANCE: return apply_disturbance(a, payload, len);
    case PROTO_T_CONTROL:     return apply_control(a, payload, len, now_us);
    default:                  return AGENT_ERR_TYPE;
    }
}
```

## src/agent.h
```c
/**
 * @file agent.h
 * @brief Agent state and configuration decoding.
 *
 * All scaled quantities are int32 in units of 1e-6, matching the platform's
 * fixed-point convention (`vertex/numeric.py`). Fields arrive little-endian.
 *
 * ## Payload formats
 *
 * `proto.h` owns the *envelope* -- SOF, type, length, CRC -- which is identical
 * for every message on the link.
 *
 *     NETWORK  'N'=0x4E  >= 2 bytes, variable
 *       [enabled:1][node_id:1][neighbor_id:1 x n]
 *       enabled is 1 or 0; node_id 0 is reserved. n may be 0.
 *
 *     ALGORITHM  'A'=0x41  36 bytes
 *       [dt_ms:4][clock_ms:4][state_0:4][vstate_0:4][vartheta_0:4]
 *       [counter_0:4][gain_ij:4][delta:4][eta:4][alpha:4]
 *       dt is the control period, clock the communication update period. 
 *
 *     DISTURBANCE  'D'=0x44  29 bytes
 *       [active:1][sine_amplitude:4][frequency:4][phase:4]
 *       [noise_amplitude:4][noise_offset:4][beta:4][samples:4]
 *       nu(t) = noise_amplitude*(U - noise_offset) + beta
 *               + sine_amplitude*sin(2*pi*frequency*(t - phase))
 *       noise_offset shifts the uniform draw, so 0.5 centres the noise on zero;
 *       it is not added to the output. samples must be > 0 -- the step counter
 *       wraps modulo it, so it sets the disturbance's repeat period.
 *
 *     CONTROL  'S'=0x53  11 bytes
 *       [run:1][seed:4][epoch_us:6]
 *       run=1 latches initial conditions, seeds the PRNG and starts the run;
 *       run=0 stops it. `seed` is a uint32.
 *
 *       `epoch_us` is the host's own clock reading, in microseconds since the
 *       experiment epoch, taken as it built this frame. 
 *
 *     RADIO  'R'=0x52  9 bytes
 *       [adv_min:2][adv_max:2][scan_int:2][scan_win:2][flags:1], 0.625 ms units
 *       flags bit0 = active scan (else passive), bit1 = advertising enabled.
 *       Requires scan_int != 0 and scan_win <= scan_int.
 *
 * The reply direction is documented where it is built: see `report.h` for STATE.
 */

#ifndef AGENT_H_
#define AGENT_H_

#include <stdbool.h>
#include <stdint.h>

#include "common.h"
#include "proto.h"


#define AGENT_MAX_NEIGHBORS     N_MAX_NEIGHBORS

#if AGENT_MAX_NEIGHBORS > PROTO_MAX_NEIGHBORS
#error "AGENT_MAX_NEIGHBORS exceeds what a NETWORK frame can carry"
#endif

/* Errors returned by agent_apply_frame */
#define AGENT_OK                0
#define AGENT_ERR_LEN          (-1)     /* payload length wrong for the type */
#define AGENT_ERR_RANGE        (-2)     /* a field is out of range */
#define AGENT_ERR_TYPE         (-3)     /* not a configuration frame */

/* RADIO flag bits, as documented above. */
#define AGENT_RADIO_ACTIVE_SCAN 0x01u
#define AGENT_RADIO_ADVERTISING 0x02u

/**
 * @brief Which control law this node runs.
 *
 * Both laws are compiled in and the manifest chooses, exactly as the Python
 * side does through its controller registry. 
 * 
 * Examples are: 
 *      (1) `finite_time_adaptive` as the scalar law for a 30-agent campaign run, 
 *      (2) `microgrid_*` is the five-DG benchmark as the cyber-physical system.
 *              - Runs a baseline controller interface: LAW_MICROGRID_LC
 *              - Runs an always adaptive and dead-zone physical interface: LAW_MICROGRID_ADAPTIVE
 */
/** @brief Bits in `agent_params.mg_blocks`. */
#define MG_BLOCK_PLANT      0x01u
#define MG_BLOCK_VIRTUAL    0x02u

enum control_law {
    LAW_FINITE_TIME_ADAPTIVE = 0,
    LAW_MICROGRID_ADAPTIVE   = 1,   /* C_AA when eps = 0, C_DZ otherwise */
    LAW_MICROGRID_LC         = 2,   /* C_LC0 when terminal, C_LC+ otherwise */
};

/**
 * @brief The microgrid benchmark's parameters, all of them.
 * 
 * Runs a pinned consensus law. 
 *
 * Scaled int32 on the wire like everything else, converted once on receipt.
 * `S1`/`S2` are the emulator's unknown: they reach the plant and nothing
 * else reads them, which is the same information barrier the Python side
 * gets by not handing an interface a reference to the plant.
 *
 * `b`, `rP` and `rQ` are nonzero only on the pinned node. An unpinned board
 * is never sent the reference, so "one node knows it" is a property of what
 * crossed the serial link.
 */
struct microgrid_params {
    /* plant */
    int32_t kappa;              /* rating share, scaled */
    int32_t S1, S2;             /* the unknown parameter, emulator only */
    int32_t p_max, q_max;       /* nameplate, scaled */
    uint8_t profile;            /* 0 = rep (decaying), 1 = per (persistent) */
    /* common virtual layer */
    int32_t T_o;                /* observer deadline, ms */
    int32_t alpha_0;
    int32_t delta_o;            /* regularization width, ms */
    int32_t kappa_o;
    int32_t xi;
    int32_t c_0;
    int32_t b;                  /* pinning coefficient; 0 on all but one */
    int32_t rP, rQ;             /* the reference; meaningful only where b > 0 */
    int32_t degree;             /* sum_j a_ij, so the layer can size its sum */
    /* physical interface */
    int32_t mu_max;
    int32_t gamma;              /* adaptive: increment per update */
    int32_t eps;                /* adaptive: dead zone; 0 selects C_AA */
    int32_t vartheta_0;
    int32_t T_c;                /* lc: control deadline, ms */
    int32_t beta_c;             /* lc */
    int32_t Phi;                /* lc: adaptation gain */
    int32_t delta_c;            /* lc: regularization width, ms; 0 means 2h */
    int32_t adapt_band;         /* lc: hold the update until |sigma|_1 <= this;
                                   negative means no gate */
    uint8_t terminal;           /* lc: 1 selects C_LC0 */
    /* initial condition, PHYSICAL coordinates: the nameplate constrains it
       there, and the node normalizes by kappa. */
    int32_t X0_P, X0_Q;
    int32_t z0_P, z0_Q;
};

/** @brief Integrator state for the microgrid laws. Two coordinates each. */
struct microgrid_vars {
    float xP, xQ;               /* normalized plant state */
    float zP, zQ;               /* virtual state, the only thing transmitted */
    float c;                    /* observer gain, local */
    float wP, wQ;               /* held neighbour sum, frozen for the tick */
    float vartheta;             /* adaptive interface */
    float S1_hat, S2_hat;       /* lc interface: the ESTIMATE */
    uint32_t updates;
    uint8_t  watchdog;          /* 0 = inside the envelope, else the cause */
    uint16_t sat_run;           /* consecutive saturated updates */
};

struct disturbance_params {
    bool    active;
    int32_t sine_amplitude;     /* M        */
    int32_t frequency;
    int32_t phase;
    int32_t noise_amplitude;    /* O        */
    int32_t noise_offset;       /* O_offset */
    int32_t beta;
    int32_t samples;
};

struct agent_params {
    bool    enabled;
    bool    running;
    bool    first_time_running;
    bool    all_neighbors_observed;

    uint8_t node_id;
    uint8_t n_neighbors;
    uint8_t neighbors_id[AGENT_MAX_NEIGHBORS];
    
    bool    available_neighbors[AGENT_MAX_NEIGHBORS];
    bool    neighbors_enabled[AGENT_MAX_NEIGHBORS];

    int32_t  dt;                /* ms */
    int32_t  clock;             /* ms */
    int32_t  state_0;
    int32_t  vstate_0;
    int32_t  vartheta_0;
    int32_t  counter_0;
    int32_t  gain_ij;           /* coupling gain: a_ij */
    int32_t  alpha;             /* sign-power exponent */
    int32_t  delta;
    int32_t  eta;
    uint32_t seed;              /* per-node, per-run PRNG seed, from CONTROL */
    uint64_t epoch_us;          /* host's epoch reading at trigger, from CONTROL */

    /* Reset to LAW_FINITE_TIME_ADAPTIVE by every NETWORK frame, so each
     * configuration sequence re-declares it and a stale selection cannot
     * survive a reconfigure. */
    /* TODO: we still need to figure out */
    enum control_law law;
    /* Which microgrid blocks have arrived since the last NETWORK frame.
     * MG_IFACE commits the law and refuses until both others are present. */
    uint8_t mg_blocks;

    struct disturbance_params disturbance;
    struct microgrid_params microgrid;
};

struct agent_vars {
    /* Published state, scaled int32. Derived from the accumulators below on every
     * step; read by report.c and the broadcaster. Never integrated. */
    int32_t state;
    int32_t vstate;
    int32_t vartheta;
    int32_t counter;
    int64_t time_us;            /* run start, local uptime, MICROSECONDS */
    /* Per-neighbour reception state, absorbed from the observer. */
    uint16_t neighbor_seq[AGENT_MAX_NEIGHBORS];
    int8_t   neighbor_rssi[AGENT_MAX_NEIGHBORS];
    uint16_t tx_seq;

    /* Second coordinate of this node's own state, scaled. Written only by
     * the microgrid laws; the scalar law is one-dimensional and leaves them
     * zero, which is why the STATE frame carries them only when a microgrid
     * law is selected. */
    /* TODO: make an array version of these two variable states */
    int32_t state_q;
    int32_t vstate_q;

    int32_t neighbor_vstates[AGENT_MAX_NEIGHBORS];
    /* Second virtual coordinate, written only by a v2 frame. The scalar law
     * never reads it and a v1 frame never writes it, so the two families can
     * share a receive path without either seeing the other's leftovers. */
    /* TODO: again, there should only be one neighbor_vstates_* so these must me a 2-D vector/ array */
    int32_t neighbor_vstates_q[AGENT_MAX_NEIGHBORS];

    /* Full-precision integrator, scalar law. */
    float state_f;
    float vstate_f;
    float vartheta_f;

    /* Integrator for the microgrid laws. A separate struct and not a union:
     * the two laws never run at once, but aliasing their state would make a
     * mis-set `law` corrupt silently instead of simply running the wrong
     * equations. */
    /* I like this way of adding user-systems to study, for example here we can add different plants from another .{h,c} file */
    struct microgrid_vars mg;
};

struct agent {
    struct agent_params params;
    struct agent_vars   vars;
};

/** @brief Radio configuration decoded from a RADIO frame, in 0.625 ms units. */
struct radio_params {
    uint16_t adv_min;
    uint16_t adv_max;
    uint16_t scan_interval;
    uint16_t scan_window;
    bool     active_scan;
    bool     advertising;
};

void agent_init(struct agent *a);

/**
 * @brief Apply one configuration frame.
 *
 * Handles NETWORK, ALGORITHM, DISTURBANCE and CONTROL -- the frames that change
 * agent state. RADIO is deliberately not one of them: it configures the radio,
 * not the agent, so it decodes through agent_parse_radio() and is applied by
 * whoever owns the radio.
 *
 * @param now_us Current time, injected so this unit stays host-testable. Only
 *               read when a control frame starts a run.
 * @return AGENT_OK, or a negative AGENT_ERR_*. The caller reports the failure to
 *         the host; a rejected frame must never be partially applied, which is
 *         why every length check precedes the first assignment.
 */
int agent_apply_frame(struct agent *a, uint8_t type, const uint8_t *payload,
                      uint16_t len, int64_t now_us);

/**
 * @brief Decode and validate a RADIO payload.
 *
 * Split from applying it so the bounds check sits beside the other frame
 * decoders and stays host-testable, while the effect -- restarting the scanner --
 * stays in the module that owns the radio.
 *
 * @return AGENT_OK, or AGENT_ERR_LEN / AGENT_ERR_RANGE. @p out is untouched on
 *         failure, so a rejected frame cannot half-apply.
 */
int agent_parse_radio(const uint8_t *payload, uint16_t len,
                      struct radio_params *out);

/** @brief Index of @p node in the neighbour list, or -1. */
int8_t agent_neighbor_index(const struct agent *a, uint8_t node);

#endif /* AGENT_H_ */
```

## src/air_wire.c
```c
#include "air_wire.h"

/* Little-endian byte pokes, local rather than borrowed from proto.h: that header
 * is the *serial* envelope, and coupling the radio format to it would mean a
 * change to one silently reaching the other. */
static inline void st_u16(uint8_t *p, uint16_t v)
{
	p[0] = (uint8_t)(v & 0xFFu);
	p[1] = (uint8_t)(v >> 8);
}

static inline uint16_t ld_u16(const uint8_t *p)
{
	return (uint16_t)((uint16_t)p[0] | ((uint16_t)p[1] << 8));
}

static inline void st_u32(uint8_t *p, uint32_t v)
{
	p[0] = (uint8_t)(v & 0xFFu);
	p[1] = (uint8_t)((v >> 8) & 0xFFu);
	p[2] = (uint8_t)((v >> 16) & 0xFFu);
	p[3] = (uint8_t)((v >> 24) & 0xFFu);
}

static inline uint32_t ld_u32(const uint8_t *p)
{
	return (uint32_t)p[0] | ((uint32_t)p[1] << 8) |
	       ((uint32_t)p[2] << 16) | ((uint32_t)p[3] << 24);
}

static inline void st_u48(uint8_t *p, uint64_t v)
{
	for (unsigned i = 0; i < 6u; i++) {
		p[i] = (uint8_t)((v >> (8u * i)) & 0xFFu);
	}
}

static inline uint64_t ld_u48(const uint8_t *p)
{
	uint64_t v = 0;
	for (unsigned i = 0; i < 6u; i++) {
		v |= (uint64_t)p[i] << (8u * i);
	}
	return v;
}

int air_wire_encode_v1(const state_packet_type *p, uint8_t *out, size_t cap)
{
	if (cap < AIR_WIRE_AD_VALUE_SIZE) {
		return AIR_WIRE_ERR_LEN;
	}
	st_u16(&out[0], (uint16_t)MANUFACTURER_ID);

	uint8_t *v = &out[2];
	v[0] = (uint8_t)AIR_WIRE_V1_VERSION;
	v[1] = (uint8_t)((p->enabled        ? AIR_WIRE_V1_FLAG_ENABLED     : 0u) |
	                 (p->disturbance_on ? AIR_WIRE_V1_FLAG_DISTURBANCE : 0u));
	v[2] = p->node;
	v[3] = 0u;                          /* reserved; the host rejects nonzero */
	st_u16(&v[4], p->seq);
	st_u32(&v[6], (uint32_t)p->vstate);
	/* uint48: the top 16 bits of tx_time_us are dropped, which is 8.9 years of
	 * microseconds. */
	st_u48(&v[10], p->tx_time_us);
	return (int)AIR_WIRE_AD_VALUE_SIZE;
}

int air_wire_encode_v2(const state_packet_type *p, uint8_t *out, size_t cap)
{
	if (cap < AIR_WIRE_V2_AD_VALUE_SIZE) {
		return AIR_WIRE_ERR_LEN;
	}
	st_u16(&out[0], (uint16_t)MANUFACTURER_ID);

	uint8_t *v = &out[2];
	v[0] = (uint8_t)AIR_WIRE_V2_VERSION;
	v[1] = (uint8_t)((p->enabled        ? AIR_WIRE_V1_FLAG_ENABLED     : 0u) |
	                 (p->disturbance_on ? AIR_WIRE_V1_FLAG_DISTURBANCE : 0u));
	v[2] = p->node;
	/* No reserved byte: the frame is already 19 and a spare byte nothing
	 * reads is not worth three more on the air. */
	st_u16(&v[3], p->seq);
	st_u32(&v[5], (uint32_t)p->vstate);
	st_u32(&v[9], (uint32_t)p->vstate_q);
	st_u48(&v[13], p->tx_time_us);
	return (int)AIR_WIRE_V2_AD_VALUE_SIZE;
}

int air_wire_encode(const state_packet_type *p, uint8_t *out, size_t cap)
{
	return (p->coords >= 2u) ? air_wire_encode_v2(p, out, cap)
	                         : air_wire_encode_v1(p, out, cap);
}

static int decode_v2(const uint8_t *v, state_packet_type *out)
{
	if (v[0] != (uint8_t)AIR_WIRE_V2_VERSION) {
		return AIR_WIRE_ERR_FORMAT;
	}
	if (v[2] == 0u) {
		return AIR_WIRE_ERR_FORMAT;         /* node id 0 is reserved */
	}
	out->node = v[2];
	out->enabled = (v[1] & AIR_WIRE_V1_FLAG_ENABLED) != 0u;
	out->disturbance_on = (v[1] & AIR_WIRE_V1_FLAG_DISTURBANCE) != 0u;
	out->seq = ld_u16(&v[3]);
	out->vstate = (int32_t)ld_u32(&v[5]);
	out->vstate_q = (int32_t)ld_u32(&v[9]);
	out->tx_time_us = ld_u48(&v[13]);
	out->has_seq_and_time = true;
	out->coords = 2u;
	return AIR_WIRE_OK;
}

static int decode_v1(const uint8_t *v, state_packet_type *out)
{
	if (v[0] != (uint8_t)AIR_WIRE_V1_VERSION) {
		return AIR_WIRE_ERR_FORMAT;
	}
	if (v[3] != 0u) {
		/* Reserved byte. Rejected, not ignored, so a future v1.x that uses it
		 * cannot be silently misread as this version. Same rule as the host. */
		return AIR_WIRE_ERR_FORMAT;
	}
	if (v[2] == 0u) {
		return AIR_WIRE_ERR_FORMAT;         /* node id 0 is reserved */
	}

	out->node             = v[2];
	out->enabled          = (v[1] & AIR_WIRE_V1_FLAG_ENABLED) != 0u;
	out->disturbance_on   = (v[1] & AIR_WIRE_V1_FLAG_DISTURBANCE) != 0u;
	out->seq              = ld_u16(&v[4]);
	out->vstate           = (int32_t)ld_u32(&v[6]);
	out->tx_time_us       = ld_u48(&v[10]);
	out->has_seq_and_time = true;
	out->coords = 1u;
	out->vstate_q = 0;
	return AIR_WIRE_OK;
}

static int decode_v0(const uint8_t *v, state_packet_type *out)
{
	if (v[0] != AIR_WIRE_V0_FLAG_ENABLED && v[0] != AIR_WIRE_V0_FLAG_DISABLED) {
		return AIR_WIRE_ERR_FORMAT;
	}
	if (v[1] == 0u) {
		return AIR_WIRE_ERR_FORMAT;         /* node id 0 is reserved */
	}

	out->node           = v[1];
	out->enabled        = (v[0] == AIR_WIRE_V0_FLAG_ENABLED);
	out->disturbance_on = false;
	out->vstate         = (int32_t)ld_u32(&v[2]);
	out->seq              = 0u;
	out->tx_time_us       = 0u;
	out->has_seq_and_time = false;
	out->coords = 1u;
	out->vstate_q = 0;
	return AIR_WIRE_OK;
}

int air_wire_decode_any(const uint8_t *value, size_t len, state_packet_type *out)
{
	if (len < 2u) {
		return AIR_WIRE_ERR_LEN;
	}
	if (ld_u16(value) != (uint16_t)MANUFACTURER_ID) {
		return AIR_WIRE_ERR_COMPANY;
	}

	state_packet_type tmp = {0};
	int rc;

	/* Dispatch on length, then verify the version byte. Both formats are fixed
	 * size, so a length that matches neither is not a truncated packet worth
	 * guessing at. */
	if (len == AIR_WIRE_V2_AD_VALUE_SIZE) {
		rc = decode_v2(&value[2], &tmp);
	} else if (len == AIR_WIRE_AD_VALUE_SIZE) {
		rc = decode_v1(&value[2], &tmp);
	} else if (len == AIR_WIRE_V0_AD_VALUE_SIZE) {
		rc = decode_v0(&value[2], &tmp);
	} else {
		return AIR_WIRE_ERR_LEN;
	}

	if (rc != AIR_WIRE_OK) {
		return rc;                      /* out untouched: no half-decoded packet */
	}
	*out = tmp;
	return AIR_WIRE_OK;
}
```

## src/air_wire.h
```c
/**
 * @file air_wire.h
 * @brief The on-air state packet. Mirrors `vertex/wire/codec.py`.
 *
 * ## v1 -- 16 bytes, little-endian
 *
 *     off  size  type    field
 *     0    1     uint8   version = 1
 *     1    1     uint8   flags: bit0 enabled, bit1 disturbance_on
 *     2    1     uint8   node_id, 1..255
 *     3    1     uint8   reserved, must be 0 (the host rejects nonzero, so v1.x
 *                        can claim it)
 *     4    2     uint16  seq, wraps mod 2^16
 *     6    4     int32   vstate, scaled by 1e6
 *     10   6     uint48  tx_time_us, microseconds since the experiment epoch
 *
 * The manufacturer-specific AD element's *value* is the two-byte company id then
 * this payload: 18 bytes. With the name element that is 9 + (2 + 18) = 29 of the
 * 31 available.
 *
 * ## tx_time_us is on the *host's* epoch, not this board's uptime
 *
 */

#ifndef AIR_WIRE_H_
#define AIR_WIRE_H_

#include <stdbool.h>
#include <stddef.h>
#include <stdint.h>

#include "common.h"

#define AIR_WIRE_V1_VERSION             1u
#define AIR_WIRE_V1_PAYLOAD_SIZE        16u
/* v2: the same header without the reserved byte, then two int32 coordinates.
 * 5 + 8 + 6 = 19. Carried by the microgrid family, whose virtual state has
 * two components; the version follows from how many there are, so a frame
 * cannot disagree with its own contents. */
#define AIR_WIRE_V2_VERSION             2u
#define AIR_WIRE_V2_PAYLOAD_SIZE        19u
#define AIR_WIRE_V1_FLAG_ENABLED        0x01u
#define AIR_WIRE_V1_FLAG_DISTURBANCE    0x02u

/** Company id (2) + v1 payload (16). The AD element's value, what `bt_data_parse`
 *  hands back as `data->data` / `data->data_len`. */
#define AIR_WIRE_AD_VALUE_SIZE          (2u + AIR_WIRE_V1_PAYLOAD_SIZE)
#define AIR_WIRE_V2_AD_VALUE_SIZE       (2u + AIR_WIRE_V2_PAYLOAD_SIZE)
/* The larger of the two, for a buffer that must hold either. 23 of the 31 AD
 * bytes, with the Complete Local Name already gone -- nothing read it and
 * every receiver filters on the company id. */
#define AIR_WIRE_AD_VALUE_MAX           AIR_WIRE_V2_AD_VALUE_SIZE

/* v0: the 6-byte payload this firmware used to transmit. Decode only. */
#define AIR_WIRE_V0_PAYLOAD_SIZE        6u
#define AIR_WIRE_V0_FLAG_ENABLED        0x7Fu
#define AIR_WIRE_V0_FLAG_DISABLED       0x70u
#define AIR_WIRE_V0_AD_VALUE_SIZE       (2u + AIR_WIRE_V0_PAYLOAD_SIZE)

#define AIR_WIRE_OK              0
#define AIR_WIRE_ERR_LEN        (-1)    /* not a length either version uses */
#define AIR_WIRE_ERR_COMPANY    (-2)    /* somebody else's manufacturer data */
#define AIR_WIRE_ERR_FORMAT     (-3)    /* right length, unreadable content */

/** One agent's broadcast state, in the units the wire uses. */
typedef struct {
	uint8_t  node;
	bool     enabled;
	bool     disturbance_on;
	uint16_t seq;
	int32_t  vstate;            /* scaled by 1e6; the P coordinate on v2 */
	int32_t  vstate_q;          /* Q coordinate, v2 only; 0 on v1 and v0 */
	/* 1 for v1 and v0, 2 for v2. The encoder picks the frame from this and
	 * the decoder sets it, so neither side has to be told separately. */
	uint8_t  coords;
	uint64_t tx_time_us;        /* experiment epoch; uint48 on the wire */
	/** Set by the decoder: false when the packet was v0, which carries no
	 *  sequence number and no timestamp. */
	bool     has_seq_and_time;
} state_packet_type;

/**
 * @brief Encode a v1 AD element value: company id, then the payload.
 *
 * @return AIR_WIRE_AD_VALUE_SIZE, or AIR_WIRE_ERR_LEN if @p cap is too small.
 */
int air_wire_encode_v1(const state_packet_type *p, uint8_t *out, size_t cap);

/**
 * @brief Encode a v2 AD element value: company id, then two coordinates.
 *
 * @return AIR_WIRE_V2_AD_VALUE_SIZE, or AIR_WIRE_ERR_LEN if @p cap is small.
 */
int air_wire_encode_v2(const state_packet_type *p, uint8_t *out, size_t cap);

/**
 * @brief Encode whichever frame @p p needs, from its coordinate count.
 */
int air_wire_encode(const state_packet_type *p, uint8_t *out, size_t cap);

/**
 * @brief Decode an AD element value, v1 or v0.
 *
 * @param value `data->data` from bt_data_parse -- company id included.
 * @return AIR_WIRE_OK, or a negative AIR_WIRE_ERR_*. @p out is untouched on failure.
 */
int air_wire_decode_any(const uint8_t *value, size_t len, state_packet_type *out);

#endif /* AIR_WIRE_H_ */
```

## src/broadcaster.h
```c
/**
 * @file broadcaster.h
 * @brief Advertising: put this agent's vstate on the air.
 */

#ifndef BROADCASTER_H_
#define BROADCASTER_H_

#include <stdbool.h>
#include <stdint.h>

#include "common.h"
#include "air_wire.h"

/** Requested TX power in dBm. */
#define TX_POWER_LEVEL_BLE    8

/**
 * @brief Set the advertising interval, in 0.625 ms units.
 *
 * Takes effect on the next broadcaster_init(). Advertising parameters are only
 * settable while advertising is stopped.
 *
 * @return 0, or -EINVAL if min is zero or exceeds max.
 */
/** Sentinel for `granted_tx_power` before the vendor command has answered. */
#define BROADCASTER_TX_POWER_UNKNOWN  (-128)

/** Advertising parameters in force, and the Tx power the controller GRANTED.
 *
 *  The granted value is the one worth recording: it differed from the requested
 *  one on every board until CONFIG_BT_CTLR_TX_PWR_DYNAMIC_CONTROL was set.
 */
struct broadcaster_stats {
	uint16_t adv_interval_min, adv_interval_max;   /* 0.625 ms units */
	int8_t   granted_tx_power;                     /* dBm, or the sentinel */
};

const struct broadcaster_stats *broadcaster_stats(void);

int broadcaster_set_adv_params(uint16_t interval_min, uint16_t interval_max);

/** @brief Start advertising @p pkt. Idempotent-safe: returns 0 if the advertiser
 *  is already running. */
int broadcaster_init(const state_packet_type *pkt);

/** @brief Replace the advertised payload. Called every control period.
 *
 *  Returns -EAGAIN if the advertiser was never started, without logging: at one
 *  call per `dt` a log line here is a flood, and the UART it floods is the same
 *  one carrying the STATE reports. */
int broadcaster_update(const state_packet_type *pkt);

int broadcaster_stop(void);

#endif // BROADCASTER_H_
```
